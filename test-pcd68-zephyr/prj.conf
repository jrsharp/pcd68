## CMakeLists.txt
```
# SPDX-License-Identifier: Apache-2.0

cmake_minimum_required(VERSION 3.20.0)

find_package(Zephyr REQUIRED HINTS $ENV{ZEPHYR_BASE})
project(pcd68_emulator_tests)

# Add PCD-68 emulator source files
target_sources(app PRIVATE
    # Moira CPU emulator
    ../src/Moira/Moira.cpp
    ../src/Moira/MoiraDebugger.cpp

    # Test files
    src/test_basic_sanity.cpp
    src/test_cpu_basic.cpp
    src/test_move.cpp
    src/test_arithmetic.cpp
    src/test_logical.cpp
    src/test_branches.cpp
    src/test_addressing_modes.cpp
    src/test_compare.cpp
    src/test_mul_div.cpp
    src/test_bit_ops.cpp
    src/test_stack_misc.cpp
)

# Include directories
target_include_directories(app PRIVATE
    ../src
    ../src/Moira
    src
)

# Compiler definitions
target_compile_definitions(app PRIVATE
    USE_MINIMAL_DISPATCH=1
    USE_ZEPHYR=1
)

# C++ standard
set_property(TARGET app PROPERTY CXX_STANDARD 17)
```

## prj.conf
```kconfig
# PCD-68 Emulator Test Configuration
CONFIG_ZTEST=y

# Increase stack size for emulator (64000 CPU emulator needs large stack)
CONFIG_MAIN_STACK_SIZE=32768
CONFIG_ZTEST_STACK_SIZE=32768

# Heap for dynamic allocation (for multiple 16KB test RAM allocations)
# 104 tests * 16KB = ~1.6MB, but many will fail early
# Allocate 384KB to allow ~24 tests to run
CONFIG_HEAP_MEM_POOL_SIZE=393216

# Enable console for test output
CONFIG_CONSOLE=y
CONFIG_UART_CONSOLE=y
CONFIG_SERIAL=y

# Enable assertions
CONFIG_ASSERT=y

# Logging (optional, can disable for speed)
CONFIG_LOG=y
CONFIG_LOG_DEFAULT_LEVEL=3

# C++ support
CONFIG_CPP=y
CONFIG_STD_CPP17=y
CONFIG_NO_OPTIMIZATIONS=y
CONFIG_CPP_EXCEPTIONS=n
CONFIG_CPP_RTTI=n

# Enable newlib for proper C++ new/delete
CONFIG_NEWLIB_LIBC=n
CONFIG_PICOLIBC=y
CONFIG_PICOLIBC_USE_MODULE=y
```

## src/main.cpp
```c
/*
 * PCD-68 Emulator Test Suite
 * Tests the Motorola 68000 CPU emulator using Zephyr's ztest framework
 */

#include <zephyr/ztest.h>
#include <zephyr/kernel.h>

/* Main test suite entry point */
int main(void)
{
    printk("\n");
    printk("========================================\n");
    printk("PCD-68 Motorola 68000 Emulator Tests\n");
    printk("========================================\n");
    printk("Testing cached runtime dispatch system\n");
    printk("Platform: %s\n", CONFIG_BOARD);
    printk("========================================\n\n");

    return 0;
}
```

## src/test_addressing_modes.cpp
```c
/*
 * Addressing Mode Tests
 * Tests various 68000 addressing modes: indirect, displacement, indexed, etc.
 */

#include <zephyr/ztest.h>
#include "test_helper.h"

ZTEST_SUITE(addressing_modes, NULL, NULL, NULL, NULL, NULL);

ZTEST(addressing_modes, test_address_register_indirect)
{
    TestMemory cpu;
    cpu.write_long(0, 0x00001000);
    cpu.write_long(4, 0x00000400);
    // Setup: A0 points to 0x600, write value at 0x600
    cpu.writeA(0, 0x600);
    cpu.write_word(0x600, 0x1234);

    // MOVE.W (A0),D0  - Address Register Indirect
    cpu.write_word(0x400, 0x3010);  // MOVE.W (A0),D0

    cpu.reset();  // Reset AFTER writing instructions
    cpu.execute();

    zassert_equal(cpu.readD(0), 0x1234, "D0 should contain value from (A0)");
    printk("✓ Address register indirect test passed\n");
}

ZTEST(addressing_modes, test_address_register_indirect_postincrement)
{
    TestMemory cpu;
    cpu.write_long(0, 0x00001000);
    cpu.write_long(4, 0x00000400);
    // Setup: A1 points to 0x700
    cpu.writeA(1, 0x700);
    cpu.write_word(0x700, 0x5678);

    // MOVE.W (A1)+,D1  - Post-increment
    cpu.write_word(0x400, 0x3219);  // MOVE.W (A1)+,D1

    cpu.reset();  // Reset AFTER writing instructions
    cpu.execute();

    zassert_equal(cpu.readD(1), 0x5678, "D1 should contain value from (A1)");
    zassert_equal(cpu.readA(1), 0x702, "A1 should increment by 2");
    printk("✓ Post-increment test passed\n");
}

ZTEST(addressing_modes, test_address_register_indirect_predecrement)
{
    TestMemory cpu;
    cpu.write_long(0, 0x00001000);
    cpu.write_long(4, 0x00000400);
    // Setup: A2 points to 0x702, value at 0x700
    cpu.writeA(2, 0x702);
    cpu.write_word(0x700, 0x9ABC);

    // MOVE.W -(A2),D2  - Pre-decrement
    cpu.write_word(0x400, 0x3422);  // MOVE.W -(A2),D2

    cpu.reset();  // Reset AFTER writing instructions
    cpu.execute();

    zassert_equal(cpu.readD(2), 0x9ABC, "D2 should contain value");
    zassert_equal(cpu.readA(2), 0x700, "A2 should decrement by 2 before read");
    printk("✓ Pre-decrement test passed\n");
}

ZTEST(addressing_modes, test_address_register_displacement)
{
    TestMemory cpu;
    cpu.write_long(0, 0x00001000);
    cpu.write_long(4, 0x00000400);
    // Setup: A3 points to 0x800, value at 0x810
    cpu.writeA(3, 0x800);
    cpu.write_word(0x810, 0xDEF0);

    // MOVE.W (16,A3),D3  - Address register with displacement
    cpu.write_word(0x400, 0x362B);  // MOVE.W (d16,A3),D3
    cpu.write_word(0x402, 0x0010);  // displacement = +16

    cpu.reset();  // Reset AFTER writing instructions
    cpu.execute();

    zassert_equal(cpu.readD(3), 0xDEF0, "D3 should contain value from (A3+16)");
    printk("✓ Address register with displacement test passed\n");
}

ZTEST(addressing_modes, test_absolute_short_addressing)
{
    TestMemory cpu;
    cpu.write_long(0, 0x00001000);
    cpu.write_long(4, 0x00000400);

    // Write value at absolute address 0x900
    cpu.write_word(0x900, 0x2468);

    // MOVE.W $900,D4  - Absolute short addressing
    cpu.write_word(0x400, 0x3838);  // MOVE.W (xxx).W,D4
    cpu.write_word(0x402, 0x0900);  // address = 0x900

    cpu.reset();  // Reset AFTER writing instructions
    cpu.execute();

    zassert_equal(cpu.readD(4), 0x2468, "D4 should contain value from absolute address");
    printk("✓ Absolute short addressing test passed\n");
}

ZTEST(addressing_modes, test_absolute_long_addressing)
{
    TestMemory cpu;
    cpu.write_long(0, 0x00001000);
    cpu.write_long(4, 0x00000400);

    // Write value at absolute address 0x1000
    cpu.write_word(0x1000, 0xACE0);

    // MOVE.W $1000,D5  - Absolute long addressing
    cpu.write_word(0x400, 0x3A39);  // MOVE.W (xxx).L,D5
    cpu.write_long(0x402, 0x00001000);  // address = 0x1000

    cpu.reset();  // Reset AFTER writing instructions
    cpu.execute();

    zassert_equal(cpu.readD(5), 0xACE0, "D5 should contain value from absolute long address");
    printk("✓ Absolute long addressing test passed\n");
}

ZTEST(addressing_modes, test_pc_relative_displacement)
{
    TestMemory cpu;
    cpu.write_long(0, 0x00001000);
    cpu.write_long(4, 0x00000400);
    // Write value at 0x412 (PC=0x402 + displacement of 0x10)
    cpu.write_word(0x412, 0xBEEF);

    // MOVE.W (d16,PC),D6  - PC-relative with displacement
    cpu.write_word(0x400, 0x3C3A);  // MOVE.W (d16,PC),D6
    cpu.write_word(0x402, 0x0010);  // displacement = +16

    cpu.reset();  // Reset AFTER writing instructions
    cpu.execute();

    zassert_equal(cpu.readD(6), 0xBEEF, "D6 should contain value from PC+displacement");
    printk("✓ PC-relative addressing test passed\n");
}

ZTEST(addressing_modes, test_immediate_mode)
{
    TestMemory cpu;
    cpu.write_long(0, 0x00001000);
    cpu.write_long(4, 0x00000400);
    // MOVE.W #$CAFE,D7  - Immediate data
    cpu.write_word(0x400, 0x3E3C);  // MOVE.W #imm,D7
    cpu.write_word(0x402, 0xCAFE);  // immediate value

    cpu.reset();  // Reset AFTER writing instructions
    cpu.execute();

    zassert_equal(cpu.readD(7), 0xCAFE, "D7 should contain immediate value");
    printk("✓ Immediate addressing test passed\n");
}

ZTEST(addressing_modes, test_write_to_memory_indirect)
{
    TestMemory cpu;
    cpu.write_long(0, 0x00001000);
    cpu.write_long(4, 0x00000400);
    // Setup: D0 = 0x1234, A4 = 0xA00
    cpu.writeD(0, 0x1234);
    cpu.writeA(4, 0xA00);

    // MOVE.W D0,(A4)  - Write to address register indirect
    cpu.write_word(0x400, 0x3880);  // MOVE.W D0,(A4)

    cpu.reset();  // Reset AFTER writing instructions
    cpu.execute();

    uint16_t value = cpu.read16(0xA00);
    zassert_equal(value, 0x1234, "Memory at (A4) should contain D0 value");
    printk("✓ Write to memory (indirect) test passed\n");
}

ZTEST(addressing_modes, test_stack_operations)
{
    TestMemory cpu;
    cpu.write_long(0, 0x00001000);
    cpu.write_long(4, 0x00000400);
    // SP is A7, set to 0x1000
    cpu.writeA(7, 0x1000);
    cpu.writeD(1, 0xABCD);

    // MOVE.W D1,-(A7)  - Push D1 onto stack
    cpu.write_word(0x400, 0x3F01);  // MOVE.W D1,-(A7)

    cpu.reset();  // Reset AFTER writing instructions
    cpu.execute();

    zassert_equal(cpu.readA(7), 0x0FFE, "SP should decrement by 2");
    uint16_t stack_value = cpu.read16(0x0FFE);
    zassert_equal(stack_value, 0xABCD, "Stack should contain D1 value");
    printk("✓ Stack push test passed\n");
}
```

## src/test_arithmetic.cpp
```c
/*
 * Arithmetic Instruction Tests
 * Tests ADD, ADDA, ADDQ, SUB, SUBA, SUBQ, CMP instructions
 */

#include <zephyr/ztest.h>
#include "test_helper.h"

ZTEST_SUITE(arithmetic_instructions, NULL, NULL, NULL, NULL, NULL);

ZTEST(arithmetic_instructions, test_addq_dn)
{
    TestMemory cpu;
    cpu.write_long(0, 0x00001000);
    cpu.write_long(4, 0x00000400);
    // Setup: D0 = 10
    cpu.writeD(0, 10);

    // ADDQ #5,D0  (0x5040 | (5-1) << 9 | D0)
    cpu.write_word(0x400, 0x5A40);  // ADDQ #5,D0

    cpu.reset();  // Reset AFTER writing instructions
    cpu.execute();

    zassert_equal(cpu.readD(0), 15, "D0 should contain 15");
    printk("✓ ADDQ #5,D0 test passed\n");
}

ZTEST(arithmetic_instructions, test_subq_dn)
{
    TestMemory cpu;
    cpu.write_long(0, 0x00001000);
    cpu.write_long(4, 0x00000400);
    // Setup: D1 = 20
    cpu.writeD(1, 20);

    // SUBQ #3,D1  (0x5140 | (3-1) << 9 | D1)
    cpu.write_word(0x400, 0x5541);  // SUBQ #3,D1

    cpu.reset();  // Reset AFTER writing instructions
    cpu.execute();

    zassert_equal(cpu.readD(1), 17, "D1 should contain 17");
    printk("✓ SUBQ #3,D1 test passed\n");
}

ZTEST(arithmetic_instructions, test_add_dn_dn_word)
{
    TestMemory cpu;
    cpu.write_long(0, 0x00001000);
    cpu.write_long(4, 0x00000400);
    // Setup: D0 = 100, D1 = 50
    cpu.writeD(0, 100);
    cpu.writeD(1, 50);

    // ADD.W D1,D0  (0xD040 | D1)
    cpu.write_word(0x400, 0xD041);  // ADD.W D1,D0

    cpu.reset();  // Reset AFTER writing instructions
    cpu.execute();

    zassert_equal(cpu.readD(0), 150, "D0 should contain 150");
    printk("✓ ADD.W D1,D0 test passed\n");
}

ZTEST(arithmetic_instructions, test_add_dn_dn_long)
{
    TestMemory cpu;
    cpu.write_long(0, 0x00001000);
    cpu.write_long(4, 0x00000400);
    // Setup: D2 = 0x10000, D3 = 0x20000
    cpu.writeD(2, 0x10000);
    cpu.writeD(3, 0x20000);

    // ADD.L D3,D2  (0xD480 | D3)
    cpu.write_word(0x400, 0xD483);  // ADD.L D3,D2

    cpu.reset();  // Reset AFTER writing instructions
    cpu.execute();

    zassert_equal(cpu.readD(2), 0x30000, "D2 should contain 0x30000");
    printk("✓ ADD.L D3,D2 test passed\n");
}

ZTEST(arithmetic_instructions, test_sub_dn_dn_word)
{
    TestMemory cpu;
    cpu.write_long(0, 0x00001000);
    cpu.write_long(4, 0x00000400);
    // Setup: D0 = 100, D1 = 30
    cpu.writeD(0, 100);
    cpu.writeD(1, 30);

    // SUB.W D1,D0  (0x9040 | D1)
    cpu.write_word(0x400, 0x9041);  // SUB.W D1,D0

    cpu.reset();  // Reset AFTER writing instructions
    cpu.execute();

    zassert_equal(cpu.readD(0), 70, "D0 should contain 70");
    printk("✓ SUB.W D1,D0 test passed\n");
}

ZTEST(arithmetic_instructions, test_sub_dn_dn_long)
{
    TestMemory cpu;
    cpu.write_long(0, 0x00001000);
    cpu.write_long(4, 0x00000400);
    // Setup: D2 = 0x50000, D3 = 0x10000
    cpu.writeD(2, 0x50000);
    cpu.writeD(3, 0x10000);

    // SUB.L D3,D2  (0x9480 | D3)
    cpu.write_word(0x400, 0x9483);  // SUB.L D3,D2

    cpu.reset();  // Reset AFTER writing instructions
    cpu.execute();

    zassert_equal(cpu.readD(2), 0x40000, "D2 should contain 0x40000");
    printk("✓ SUB.L D3,D2 test passed\n");
}

ZTEST(arithmetic_instructions, test_adda_word)
{
    TestMemory cpu;
    cpu.write_long(0, 0x00001000);
    cpu.write_long(4, 0x00000400);
    // Setup: A2 = 0x1000, D0 = 0x100
    cpu.writeA(2, 0x1000);
    cpu.writeD(0, 0x100);

    // ADDA.W D0,A2  (0xD4C0 | D0)
    cpu.write_word(0x400, 0xD4C0);  // ADDA.W D0,A2

    cpu.reset();  // Reset AFTER writing instructions
    cpu.execute();

    zassert_equal(cpu.readA(2), 0x1100, "A2 should contain 0x1100");
    printk("✓ ADDA.W D0,A2 test passed\n");
}

ZTEST(arithmetic_instructions, test_adda_long)
{
    TestMemory cpu;
    cpu.write_long(0, 0x00001000);
    cpu.write_long(4, 0x00000400);
    // Setup: A3 = 0x10000, D1 = 0x5000
    cpu.writeA(3, 0x10000);
    cpu.writeD(1, 0x5000);

    // ADDA.L D1,A3  (0xD7C1)
    cpu.write_word(0x400, 0xD7C1);  // ADDA.L D1,A3

    cpu.reset();  // Reset AFTER writing instructions
    cpu.execute();

    zassert_equal(cpu.readA(3), 0x15000, "A3 should contain 0x15000");
    printk("✓ ADDA.L D1,A3 test passed\n");
}

ZTEST(arithmetic_instructions, test_suba_word)
{
    TestMemory cpu;
    cpu.write_long(0, 0x00001000);
    cpu.write_long(4, 0x00000400);
    // Setup: A4 = 0x2000, D2 = 0x500
    cpu.writeA(4, 0x2000);
    cpu.writeD(2, 0x500);

    // SUBA.W D2,A4  (0x98C2)
    cpu.write_word(0x400, 0x98C2);  // SUBA.W D2,A4

    cpu.reset();  // Reset AFTER writing instructions
    cpu.execute();

    zassert_equal(cpu.readA(4), 0x1B00, "A4 should contain 0x1B00");
    printk("✓ SUBA.W D2,A4 test passed\n");
}

ZTEST(arithmetic_instructions, test_suba_long)
{
    TestMemory cpu;
    cpu.write_long(0, 0x00001000);
    cpu.write_long(4, 0x00000400);
    // Setup: A5 = 0x20000, D3 = 0x8000
    cpu.writeA(5, 0x20000);
    cpu.writeD(3, 0x8000);

    // SUBA.L D3,A5  (0x9BC3)
    cpu.write_word(0x400, 0x9BC3);  // SUBA.L D3,A5

    cpu.reset();  // Reset AFTER writing instructions
    cpu.execute();

    zassert_equal(cpu.readA(5), 0x18000, "A5 should contain 0x18000");
    printk("✓ SUBA.L D3,A5 test passed\n");
}

ZTEST(arithmetic_instructions, test_cmp_dn_dn)
{
    TestMemory cpu;
    cpu.write_long(0, 0x00001000);
    cpu.write_long(4, 0x00000400);
    // Setup: D0 = 50, D1 = 50
    cpu.writeD(0, 50);
    cpu.writeD(1, 50);

    // CMP.W D1,D0  (0xB040 | D1)
    cpu.write_word(0x400, 0xB041);  // CMP.W D1,D0

    // NOP to allow inspection
    cpu.write_word(0x402, 0x4E71);

    cpu.reset();  // Reset AFTER writing instructions
    cpu.execute();

    // Values should be unchanged (CMP doesn't modify operands)
    zassert_equal(cpu.readD(0), 50, "D0 should still be 50");
    zassert_equal(cpu.readD(1), 50, "D1 should still be 50");
    printk("✓ CMP.W D1,D0 test passed\n");
}
```

## src/test_basic_sanity.cpp
```c
/*
 * Basic Sanity Tests
 * Verifies test infrastructure before testing CPU instructions
 */

#include <zephyr/ztest.h>
#include "test_helper.h"

ZTEST_SUITE(basic_sanity, NULL, NULL, NULL, NULL, NULL);

ZTEST(basic_sanity, test_memory_allocation)
{
    printk("Creating TestMemory object...\n");
    TestMemory cpu;

    printk("Checking RAM allocation... ram=%p\n", cpu.ram);
    // Verify RAM was allocated
    zassert_not_null(cpu.ram, "RAM should be allocated");

    // Verify we can write and read
    printk("Writing to RAM...\n");
    cpu.ram[0] = 0x42;
    printk("Reading from RAM...\n");
    zassert_equal(cpu.ram[0], 0x42, "Should be able to write/read RAM");

    printk("✓ Memory allocation test passed\n");
}

ZTEST(basic_sanity, test_reset_vector)
{
    TestMemory cpu;

    // Set reset vectors
    cpu.write_long(0, 0x00001000);  // Initial SP
    cpu.write_long(4, 0x00000400);  // Initial PC

    cpu.reset();  // Reset to load vectors

    // Verify PC was set correctly
    uint32_t pc = cpu.getPC();
    printk("PC after reset: 0x%08x\n", pc);
    zassert_equal(pc, 0x00000400, "PC should be 0x400 after reset");

    printk("✓ Reset vector test passed\n");
}

ZTEST(basic_sanity, test_register_access)
{
    TestMemory cpu;

    // Test data register access
    cpu.writeD(0, 0x12345678);
    uint32_t d0 = cpu.readD(0);
    printk("D0: 0x%08x\n", d0);
    zassert_equal(d0, 0x12345678, "D0 should contain written value");

    // Test address register access
    cpu.writeA(1, 0xABCDEF00);
    uint32_t a1 = cpu.readA(1);
    printk("A1: 0x%08x\n", a1);
    zassert_equal(a1, 0xABCDEF00, "A1 should contain written value");

    printk("✓ Register access test passed\n");
}

ZTEST(basic_sanity, test_nop_execution)
{
    TestMemory cpu;

    cpu.write_long(0, 0x00001000);  // SP
    cpu.write_long(4, 0x00000400);  // PC
    // Write NOP instruction (0x4E71)
    cpu.write_word(0x400, 0x4E71);

    cpu.reset();  // Reset AFTER writing instructions

    uint32_t pc_before = cpu.getPC();
    printk("PC before NOP: 0x%08x\n", pc_before);

    cpu.execute();

    uint32_t pc_after = cpu.getPC();
    printk("PC after NOP: 0x%08x\n", pc_after);

    zassert_equal(pc_after, 0x402, "PC should be at 0x402 after NOP at 0x400");

    printk("✓ NOP execution test passed\n");
}
```

## src/test_bit_ops.cpp
```c
/*
 * Bit Manipulation Tests
 * Tests BSET, BCLR, BTST, BCHG, and other bit operations
 */

#include <zephyr/ztest.h>
#include "test_helper.h"

ZTEST_SUITE(bit_operations, NULL, NULL, NULL, NULL, NULL);

ZTEST(bit_operations, test_btst_set)
{
    TestMemory cpu;
    cpu.write_long(0, 0x00001000);
    cpu.write_long(4, 0x00000400);
    // Setup: D0 = 0x08 (bit 3 set)
    cpu.writeD(0, 0x08);

    // BTST #3,D0  - Test bit 3
    cpu.write_word(0x400, 0x0800);  // BTST #imm,D0
    cpu.write_word(0x402, 0x0003);  // bit number = 3

    cpu.reset();  // Reset AFTER writing instructions
    cpu.execute();

    zassert_equal(cpu.readD(0), 0x08, "D0 should be unchanged");
    // Z flag should be clear (bit is set)
    printk("✓ BTST (bit set) test passed\n");
}

ZTEST(bit_operations, test_btst_clear)
{
    TestMemory cpu;
    cpu.write_long(0, 0x00001000);
    cpu.write_long(4, 0x00000400);
    // Setup: D1 = 0x08 (bit 2 clear)
    cpu.writeD(1, 0x08);

    // BTST #2,D1  - Test bit 2
    cpu.write_word(0x400, 0x0801);  // BTST #imm,D1
    cpu.write_word(0x402, 0x0002);  // bit number = 2

    cpu.reset();  // Reset AFTER writing instructions
    cpu.execute();

    zassert_equal(cpu.readD(1), 0x08, "D1 should be unchanged");
    // Z flag should be set (bit is clear)
    printk("✓ BTST (bit clear) test passed\n");
}

ZTEST(bit_operations, test_bset_immediate)
{
    TestMemory cpu;
    cpu.write_long(0, 0x00001000);
    cpu.write_long(4, 0x00000400);
    // Setup: D2 = 0x00
    cpu.writeD(2, 0x00);

    // BSET #5,D2  - Set bit 5
    cpu.write_word(0x400, 0x08C2);  // BSET #imm,D2
    cpu.write_word(0x402, 0x0005);  // bit number = 5

    cpu.reset();  // Reset AFTER writing instructions
    cpu.execute();

    zassert_equal(cpu.readD(2), 0x20, "D2 should have bit 5 set (0x20)");
    printk("✓ BSET immediate test passed\n");
}

ZTEST(bit_operations, test_bclr_immediate)
{
    TestMemory cpu;
    cpu.write_long(0, 0x00001000);
    cpu.write_long(4, 0x00000400);
    // Setup: D3 = 0xFF
    cpu.writeD(3, 0xFF);

    // BCLR #4,D3  - Clear bit 4
    cpu.write_word(0x400, 0x0883);  // BCLR #imm,D3
    cpu.write_word(0x402, 0x0004);  // bit number = 4

    cpu.reset();  // Reset AFTER writing instructions
    cpu.execute();

    zassert_equal(cpu.readD(3), 0xEF, "D3 should have bit 4 clear (0xEF)");
    printk("✓ BCLR immediate test passed\n");
}

ZTEST(bit_operations, test_bchg_immediate)
{
    TestMemory cpu;
    cpu.write_long(0, 0x00001000);
    cpu.write_long(4, 0x00000400);
    // Setup: D4 = 0x55 (01010101)
    cpu.writeD(4, 0x55);

    // BCHG #0,D4  - Toggle bit 0
    cpu.write_word(0x400, 0x0844);  // BCHG #imm,D4
    cpu.write_word(0x402, 0x0000);  // bit number = 0

    cpu.reset();  // Reset AFTER writing instructions
    cpu.execute();

    zassert_equal(cpu.readD(4), 0x54, "D4 should have bit 0 toggled (0x54)");
    printk("✓ BCHG immediate test passed\n");
}

ZTEST(bit_operations, test_bset_register)
{
    TestMemory cpu;
    cpu.write_long(0, 0x00001000);
    cpu.write_long(4, 0x00000400);
    // Setup: D0 = 3 (bit number), D5 = 0x00
    cpu.writeD(0, 3);
    cpu.writeD(5, 0x00);

    // BSET D0,D5  - Set bit specified by D0
    cpu.write_word(0x400, 0x01C5);  // BSET D0,D5

    cpu.reset();  // Reset AFTER writing instructions
    cpu.execute();

    zassert_equal(cpu.readD(5), 0x08, "D5 should have bit 3 set (0x08)");
    printk("✓ BSET register test passed\n");
}

ZTEST(bit_operations, test_bclr_register)
{
    TestMemory cpu;
    cpu.write_long(0, 0x00001000);
    cpu.write_long(4, 0x00000400);
    // Setup: D1 = 7 (bit number), D6 = 0xFF
    cpu.writeD(1, 7);
    cpu.writeD(6, 0xFF);

    // BCLR D1,D6  - Clear bit specified by D1
    cpu.write_word(0x400, 0x0386);  // BCLR D1,D6

    cpu.reset();  // Reset AFTER writing instructions
    cpu.execute();

    zassert_equal(cpu.readD(6), 0x7F, "D6 should have bit 7 clear (0x7F)");
    printk("✓ BCLR register test passed\n");
}

ZTEST(bit_operations, test_btst_register)
{
    TestMemory cpu;
    cpu.write_long(0, 0x00001000);
    cpu.write_long(4, 0x00000400);
    // Setup: D2 = 4 (bit number), D7 = 0x10 (bit 4 set)
    cpu.writeD(2, 4);
    cpu.writeD(7, 0x10);

    // BTST D2,D7  - Test bit specified by D2
    cpu.write_word(0x400, 0x0547);  // BTST D2,D7

    cpu.reset();  // Reset AFTER writing instructions
    cpu.execute();

    zassert_equal(cpu.readD(7), 0x10, "D7 should be unchanged");
    // Z flag should be clear (bit is set)
    printk("✓ BTST register test passed\n");
}

ZTEST(bit_operations, test_bchg_register)
{
    TestMemory cpu;
    cpu.write_long(0, 0x00001000);
    cpu.write_long(4, 0x00000400);
    // Setup: D3 = 2 (bit number), D0 = 0x04 (bit 2 set)
    cpu.writeD(3, 2);
    cpu.writeD(0, 0x04);

    // BCHG D3,D0  - Toggle bit specified by D3
    cpu.write_word(0x400, 0x0740);  // BCHG D3,D0

    cpu.reset();  // Reset AFTER writing instructions
    cpu.execute();

    zassert_equal(cpu.readD(0), 0x00, "D0 should have bit 2 toggled (0x00)");
    printk("✓ BCHG register test passed\n");
}

ZTEST(bit_operations, test_bit_ops_on_high_bits)
{
    TestMemory cpu;
    cpu.write_long(0, 0x00001000);
    cpu.write_long(4, 0x00000400);
    // Setup: D1 = 0x00000000
    cpu.writeD(1, 0x00000000);

    // BSET #31,D1  - Set bit 31 (highest bit)
    cpu.write_word(0x400, 0x08C1);  // BSET #imm,D1
    cpu.write_word(0x402, 0x001F);  // bit number = 31

    cpu.reset();  // Reset AFTER writing instructions
    cpu.execute();

    zassert_equal(cpu.readD(1), 0x80000000, "D1 should have bit 31 set");
    printk("✓ Bit ops on high bits test passed\n");
}
```

## src/test_branches.cpp
```c
/*
 * Branch and Control Flow Tests
 * Tests Bcc (BEQ, BNE, BRA, etc.), JMP, JSR, RTS, LEA instructions
 */

#include <zephyr/ztest.h>
#include "test_helper.h"

ZTEST_SUITE(branch_instructions, NULL, NULL, NULL, NULL, NULL);

ZTEST(branch_instructions, test_bra_short)
{
    TestMemory cpu;
    cpu.write_long(0, 0x00001000);
    cpu.write_long(4, 0x00000400);
    // BRA.S +10  (0x6000 | displacement)
    cpu.write_word(0x400, 0x600A);  // BRA.S +10

    cpu.reset();  // Reset AFTER writing instructions
    cpu.execute();

    // PC should be at 0x400 + 2 + 10 = 0x40C
    zassert_equal(cpu.getPC(), 0x40C, "PC should be at 0x40C after BRA");
    printk("✓ BRA.S +10 test passed\n");
}

ZTEST(branch_instructions, test_beq_taken)
{
    TestMemory cpu;
    cpu.write_long(0, 0x00001000);
    cpu.write_long(4, 0x00000400);
    // Setup: Set Z flag by doing MOVEQ #0,D0
    cpu.write_word(0x400, 0x7000);  // MOVEQ #0,D0 (sets Z flag)
    cpu.write_word(0x402, 0x6708);  // BEQ.S +8

    cpu.reset();  // Reset AFTER writing instructions
    cpu.execute();  // Execute MOVEQ
    cpu.execute();  // Execute BEQ

    // PC should be at 0x402 + 2 + 8 = 0x40C
    zassert_equal(cpu.getPC(), 0x40C, "PC should be at 0x40C after BEQ taken");
    printk("✓ BEQ.S (taken) test passed\n");
}

ZTEST(branch_instructions, test_beq_not_taken)
{
    TestMemory cpu;
    cpu.write_long(0, 0x00001000);
    cpu.write_long(4, 0x00000400);
    // Setup: Clear Z flag by doing MOVEQ #1,D0
    cpu.write_word(0x400, 0x7001);  // MOVEQ #1,D0 (clears Z flag)
    cpu.write_word(0x402, 0x6708);  // BEQ.S +8

    cpu.reset();  // Reset AFTER writing instructions
    cpu.execute();  // Execute MOVEQ
    cpu.execute();  // Execute BEQ

    // PC should be at 0x402 + 2 (not taken)
    zassert_equal(cpu.getPC(), 0x404, "PC should be at 0x404 after BEQ not taken");
    printk("✓ BEQ.S (not taken) test passed\n");
}

ZTEST(branch_instructions, test_bne_taken)
{
    TestMemory cpu;
    cpu.write_long(0, 0x00001000);
    cpu.write_long(4, 0x00000400);
    // Setup: Clear Z flag by doing MOVEQ #1,D0
    cpu.write_word(0x400, 0x7001);  // MOVEQ #1,D0 (clears Z flag)
    cpu.write_word(0x402, 0x660A);  // BNE.S +10

    cpu.reset();  // Reset AFTER writing instructions
    cpu.execute();  // Execute MOVEQ
    cpu.execute();  // Execute BNE

    // PC should be at 0x402 + 2 + 10 = 0x40E
    zassert_equal(cpu.getPC(), 0x40E, "PC should be at 0x40E after BNE taken");
    printk("✓ BNE.S (taken) test passed\n");
}

ZTEST(branch_instructions, test_jmp_absolute)
{
    TestMemory cpu;
    cpu.write_long(0, 0x00001000);
    cpu.write_long(4, 0x00000400);
    // JMP 0x500  (0x4EF9 followed by long address)
    cpu.write_word(0x400, 0x4EF9);  // JMP (xxx).L
    cpu.write_long(0x402, 0x00000500);  // target address

    cpu.reset();  // Reset AFTER writing instructions
    cpu.execute();

    zassert_equal(cpu.getPC(), 0x500, "PC should be at 0x500 after JMP");
    printk("✓ JMP 0x500 test passed\n");
}

ZTEST(branch_instructions, test_jsr_rts)
{
    TestMemory cpu;
    cpu.write_long(0, 0x00001000);
    cpu.write_long(4, 0x00000400);
    uint32_t initial_sp = cpu.readA(7);

    // JSR 0x500  (0x4EB9 followed by long address)
    cpu.write_word(0x400, 0x4EB9);  // JSR (xxx).L
    cpu.write_long(0x402, 0x00000500);  // target address

    // At 0x500: RTS
    cpu.write_word(0x500, 0x4E75);  // RTS

    cpu.reset();  // Reset AFTER writing instructions
    cpu.execute();  // Execute JSR

    // Check that return address was pushed
    uint32_t sp_after_jsr = cpu.readA(7);
    zassert_equal(sp_after_jsr, initial_sp - 4, "SP should decrease by 4 after JSR");
    zassert_equal(cpu.getPC(), 0x500, "PC should be at 0x500 after JSR");

    cpu.execute();  // Execute RTS

    // Check that we returned to the instruction after JSR
    zassert_equal(cpu.getPC(), 0x406, "PC should be at 0x406 after RTS");
    zassert_equal(cpu.readA(7), initial_sp, "SP should be restored after RTS");
    printk("✓ JSR/RTS test passed\n");
}

ZTEST(branch_instructions, test_lea_absolute)
{
    TestMemory cpu;
    cpu.write_long(0, 0x00001000);
    cpu.write_long(4, 0x00000400);
    // LEA 0x2000,A2  (0x45F9 followed by long address)
    cpu.write_word(0x400, 0x45F9);  // LEA (xxx).L,A2
    cpu.write_long(0x402, 0x00002000);  // address

    cpu.reset();  // Reset AFTER writing instructions
    cpu.execute();

    zassert_equal(cpu.readA(2), 0x2000, "A2 should contain 0x2000");
    printk("✓ LEA 0x2000,A2 test passed\n");
}

ZTEST(branch_instructions, test_lea_pc_relative)
{
    TestMemory cpu;
    cpu.write_long(0, 0x00001000);
    cpu.write_long(4, 0x00000400);
    // LEA (PC,disp16),A3  (0x47FA followed by displacement)
    cpu.write_word(0x400, 0x47FA);  // LEA (d16,PC),A3
    cpu.write_word(0x402, 0x0010);  // displacement = +16

    cpu.reset();  // Reset AFTER writing instructions
    cpu.execute();

    // Effective address = PC (0x402) + 16 = 0x412
    zassert_equal(cpu.readA(3), 0x412, "A3 should contain 0x412");
    printk("✓ LEA (d16,PC),A3 test passed\n");
}

ZTEST(branch_instructions, test_bcc_unsigned_higher)
{
    TestMemory cpu;
    cpu.write_long(0, 0x00001000);
    cpu.write_long(4, 0x00000400);
    // Setup: Compare two values where D0 > D1 (unsigned)
    // MOVEQ #10,D0
    cpu.write_word(0x400, 0x700A);  // MOVEQ #10,D0
    // MOVEQ #5,D1
    cpu.write_word(0x402, 0x7205);  // MOVEQ #5,D1
    // CMP.B D1,D0
    cpu.write_word(0x404, 0xB001);  // CMP.B D1,D0
    // BHI.S +6  (0x6200 | displacement)
    cpu.write_word(0x406, 0x6206);  // BHI.S +6

    cpu.reset();  // Reset AFTER writing instructions
    cpu.execute();  // MOVEQ #10,D0
    cpu.execute();  // MOVEQ #5,D1
    cpu.execute();  // CMP.B D1,D0
    cpu.execute();  // BHI

    // PC should be at 0x406 + 2 + 6 = 0x40E
    zassert_equal(cpu.getPC(), 0x40E, "PC should be at 0x40E after BHI taken");
    printk("✓ BHI.S (taken) test passed\n");
}

ZTEST(branch_instructions, test_bls_unsigned_lower_or_same)
{
    TestMemory cpu;
    cpu.write_long(0, 0x00001000);
    cpu.write_long(4, 0x00000400);
    // Setup: Compare two equal values
    // MOVEQ #7,D0
    cpu.write_word(0x400, 0x7007);  // MOVEQ #7,D0
    // MOVEQ #7,D1
    cpu.write_word(0x402, 0x7207);  // MOVEQ #7,D1
    // CMP.B D1,D0
    cpu.write_word(0x404, 0xB001);  // CMP.B D1,D0
    // BLS.S +8
    cpu.write_word(0x406, 0x6308);  // BLS.S +8

    cpu.reset();  // Reset AFTER writing instructions
    cpu.execute();  // MOVEQ #7,D0
    cpu.execute();  // MOVEQ #7,D1
    cpu.execute();  // CMP.B D1,D0
    cpu.execute();  // BLS

    // PC should be at 0x406 + 2 + 8 = 0x410
    zassert_equal(cpu.getPC(), 0x410, "PC should be at 0x410 after BLS taken");
    printk("✓ BLS.S (taken) test passed\n");
}
```

## src/test_compare.cpp
```c
/*
 * Comparison and Condition Code Tests
 * Tests CMP, CMPA, CMPI, CMPM and condition code flag behavior
 */

#include <zephyr/ztest.h>
#include "test_helper.h"

ZTEST_SUITE(compare_tests, NULL, NULL, NULL, NULL, NULL);

ZTEST(compare_tests, test_cmp_equal)
{
    TestMemory cpu;
    cpu.write_long(0, 0x00001000);
    cpu.write_long(4, 0x00000400);
    // Setup: D0 = 100, D1 = 100
    cpu.writeD(0, 100);
    cpu.writeD(1, 100);

    // CMP.W D1,D0  - Compare D1 with D0
    cpu.write_word(0x400, 0xB041);  // CMP.W D1,D0

    cpu.reset();  // Reset AFTER writing instructions
    cpu.execute();

    // Values should remain unchanged
    zassert_equal(cpu.readD(0), 100, "D0 should be unchanged");
    zassert_equal(cpu.readD(1), 100, "D1 should be unchanged");
    // Z flag should be set (values equal) - would need SR access to verify
    printk("✓ CMP equal test passed\n");
}

ZTEST(compare_tests, test_cmp_greater)
{
    TestMemory cpu;
    cpu.write_long(0, 0x00001000);
    cpu.write_long(4, 0x00000400);
    // Setup: D0 = 200, D1 = 100
    cpu.writeD(0, 200);
    cpu.writeD(1, 100);

    // CMP.W D1,D0  - D0 > D1
    cpu.write_word(0x400, 0xB041);  // CMP.W D1,D0

    cpu.reset();  // Reset AFTER writing instructions
    cpu.execute();

    zassert_equal(cpu.readD(0), 200, "D0 should be unchanged");
    zassert_equal(cpu.readD(1), 100, "D1 should be unchanged");
    printk("✓ CMP greater test passed\n");
}

ZTEST(compare_tests, test_cmp_less)
{
    TestMemory cpu;
    cpu.write_long(0, 0x00001000);
    cpu.write_long(4, 0x00000400);
    // Setup: D0 = 50, D1 = 100
    cpu.writeD(0, 50);
    cpu.writeD(1, 100);

    // CMP.W D1,D0  - D0 < D1
    cpu.write_word(0x400, 0xB041);  // CMP.W D1,D0

    cpu.reset();  // Reset AFTER writing instructions
    cpu.execute();

    zassert_equal(cpu.readD(0), 50, "D0 should be unchanged");
    zassert_equal(cpu.readD(1), 100, "D1 should be unchanged");
    printk("✓ CMP less test passed\n");
}

ZTEST(compare_tests, test_cmpi_immediate)
{
    TestMemory cpu;
    cpu.write_long(0, 0x00001000);
    cpu.write_long(4, 0x00000400);
    // Setup: D2 = 42
    cpu.writeD(2, 42);

    // CMPI.W #42,D2  - Compare immediate with D2
    cpu.write_word(0x400, 0x0C42);  // CMPI.W #imm,D2
    cpu.write_word(0x402, 0x002A);  // immediate = 42

    cpu.reset();  // Reset AFTER writing instructions
    cpu.execute();

    zassert_equal(cpu.readD(2), 42, "D2 should be unchanged");
    printk("✓ CMPI immediate test passed\n");
}

ZTEST(compare_tests, test_cmpa_word)
{
    TestMemory cpu;
    cpu.write_long(0, 0x00001000);
    cpu.write_long(4, 0x00000400);
    // Setup: A2 = 0x1000, D3 = 0x1000
    cpu.writeA(2, 0x1000);
    cpu.writeD(3, 0x1000);

    // CMPA.W D3,A2  - Compare address register
    cpu.write_word(0x400, 0xB4C3);  // CMPA.W D3,A2

    cpu.reset();  // Reset AFTER writing instructions
    cpu.execute();

    zassert_equal(cpu.readA(2), 0x1000, "A2 should be unchanged");
    zassert_equal(cpu.readD(3), 0x1000, "D3 should be unchanged");
    printk("✓ CMPA test passed\n");
}

ZTEST(compare_tests, test_tst_zero)
{
    TestMemory cpu;
    cpu.write_long(0, 0x00001000);
    cpu.write_long(4, 0x00000400);
    // Setup: D0 = 0
    cpu.writeD(0, 0);

    // TST.L D0  - Test for zero
    cpu.write_word(0x400, 0x4A80);  // TST.L D0

    cpu.reset();  // Reset AFTER writing instructions
    cpu.execute();

    zassert_equal(cpu.readD(0), 0, "D0 should remain 0");
    // Z flag should be set
    printk("✓ TST zero test passed\n");
}

ZTEST(compare_tests, test_tst_negative)
{
    TestMemory cpu;
    cpu.write_long(0, 0x00001000);
    cpu.write_long(4, 0x00000400);
    // Setup: D1 = -1 (0xFFFFFFFF)
    cpu.writeD(1, 0xFFFFFFFF);

    // TST.L D1  - Test negative value
    cpu.write_word(0x400, 0x4A81);  // TST.L D1

    cpu.reset();  // Reset AFTER writing instructions
    cpu.execute();

    zassert_equal(cpu.readD(1), 0xFFFFFFFF, "D1 should remain -1");
    // N flag should be set
    printk("✓ TST negative test passed\n");
}

ZTEST(compare_tests, test_tst_positive)
{
    TestMemory cpu;
    cpu.write_long(0, 0x00001000);
    cpu.write_long(4, 0x00000400);
    // Setup: D2 = 0x12345678 (positive)
    cpu.writeD(2, 0x12345678);

    // TST.L D2  - Test positive value
    cpu.write_word(0x400, 0x4A82);  // TST.L D2

    cpu.reset();  // Reset AFTER writing instructions
    cpu.execute();

    zassert_equal(cpu.readD(2), 0x12345678, "D2 should be unchanged");
    // N and Z flags should be clear
    printk("✓ TST positive test passed\n");
}

ZTEST(compare_tests, test_cmp_byte)
{
    TestMemory cpu;
    cpu.write_long(0, 0x00001000);
    cpu.write_long(4, 0x00000400);
    // Setup: D0 = 0xFF (byte), D1 = 0x80 (byte)
    cpu.writeD(0, 0xFF);
    cpu.writeD(1, 0x80);

    // CMP.B D1,D0  - Compare bytes
    cpu.write_word(0x400, 0xB001);  // CMP.B D1,D0

    cpu.reset();  // Reset AFTER writing instructions
    cpu.execute();

    zassert_equal(cpu.readD(0), 0xFF, "D0 should be unchanged");
    zassert_equal(cpu.readD(1), 0x80, "D1 should be unchanged");
    printk("✓ CMP byte test passed\n");
}

ZTEST(compare_tests, test_cmp_long)
{
    TestMemory cpu;
    cpu.write_long(0, 0x00001000);
    cpu.write_long(4, 0x00000400);
    // Setup: D3 = 0x12345678, D4 = 0x12345678
    cpu.writeD(3, 0x12345678);
    cpu.writeD(4, 0x12345678);

    // CMP.L D4,D3  - Compare long words
    cpu.write_word(0x400, 0xB684);  // CMP.L D4,D3

    cpu.reset();  // Reset AFTER writing instructions
    cpu.execute();

    zassert_equal(cpu.readD(3), 0x12345678, "D3 should be unchanged");
    zassert_equal(cpu.readD(4), 0x12345678, "D4 should be unchanged");
    printk("✓ CMP long test passed\n");
}
```

## src/test_cpu_basic.cpp
```c
/*
 * Basic CPU Initialization and Reset Tests
 */

#include <zephyr/ztest.h>
#include "test_helper.h"

ZTEST_SUITE(cpu_basic, NULL, NULL, NULL, NULL, NULL);

ZTEST(cpu_basic, test_cpu_initialization)
{
    TestMemory cpu;

    // Set initial PC and SP in reset vector
    cpu.write_long(0, 0x00001000);  // Initial SP
    cpu.write_long(4, 0x00000400);  // Initial PC

    // Check that PC is set correctly
    zassert_equal(cpu.getPC(), 0x00000400, "PC should be 0x400 after reset");

    printk("✓ CPU initialization test passed\n");
}

ZTEST(cpu_basic, test_nop_instruction)
{
    TestMemory cpu;

    // Setup: PC at 0x400, SP at 0x1000
    cpu.write_long(0, 0x00001000);
    cpu.write_long(4, 0x00000400);
    // Write NOP instruction (0x4E71)
    cpu.write_word(0x400, 0x4E71);

    uint32_t pc_before = cpu.getPC();
    cpu.reset();  // Reset AFTER writing instructions
    cpu.execute();
    uint32_t pc_after = cpu.getPC();

    zassert_equal(pc_after, pc_before + 2, "PC should advance by 2 after NOP");

    printk("✓ NOP instruction test passed\n");
}

ZTEST(cpu_basic, test_multiple_nops)
{
    TestMemory cpu;

    cpu.write_long(0, 0x00001000);
    cpu.write_long(4, 0x00000400);
    // Write 5 NOP instructions
    for (int i = 0; i < 5; i++) {
        cpu.write_word(0x400 + i * 2, 0x4E71);
    }

    uint32_t initial_pc = cpu.getPC();

    // Execute 5 NOPs
    for (int i = 0; i < 5; i++) {
    cpu.reset();  // Reset AFTER writing instructions
        cpu.execute();
    }

    zassert_equal(cpu.getPC(), initial_pc + 10, "PC should advance by 10 after 5 NOPs");

    printk("✓ Multiple NOPs test passed\n");
}

ZTEST(cpu_basic, test_cache_initialization)
{
    TestMemory cpu;

    // The opcode cache should be properly initialized
    // Execute the same NOP multiple times to test cache hits
    cpu.write_long(0, 0x00001000);
    cpu.write_long(4, 0x00000400);
    // Write NOPs
    for (int i = 0; i < 100; i++) {
        cpu.write_word(0x400 + i * 2, 0x4E71);
    }

    // Execute 100 NOPs - this should exercise the cache
    for (int i = 0; i < 100; i++) {
    cpu.reset();  // Reset AFTER writing instructions
        cpu.execute();
    }

    zassert_equal(cpu.getPC(), 0x400 + 200, "PC should be at 0x4C8 after 100 NOPs");

    printk("✓ Opcode cache test passed (100 NOPs executed)\n");
}
```

## src/test_helper.h
```c
/*
 * Test Helper - Shared TestMemory class for all tests
 */

#pragma once

#include "Moira/Moira.h"
#include <string.h>
#include <zephyr/kernel.h>

using namespace moira;

// Helper class to provide memory for tests
class TestMemory : public Moira {
public:
    uint8_t* ram;  // 16KB RAM for tests (heap-allocated to avoid stack overflow)
    static constexpr size_t RAM_SIZE = 16 * 1024;

    TestMemory() {
        // Use Zephyr's k_malloc instead of C++ new
        ram = (uint8_t*)k_malloc(RAM_SIZE);
        if (!ram) {
            printk("ERROR: Failed to allocate %zu bytes for test RAM!\n", RAM_SIZE);
            return;
        }
        memset(ram, 0, RAM_SIZE);
    }

    ~TestMemory() {
        if (ram) {
            k_free(ram);
        }
    }

    // Memory access methods (required by Moira)
    uint8_t read8(uint32_t addr) override {
        if (!ram) return 0xFF;
        if (addr < RAM_SIZE) return ram[addr];
        return 0xFF;
    }

    uint16_t read16(uint32_t addr) override {
        if (!ram) return 0xFFFF;
        if (addr + 1 < RAM_SIZE) {
            return (ram[addr] << 8) | ram[addr + 1];
        }
        return 0xFFFF;
    }

    void write8(uint32_t addr, uint8_t value) override {
        if (!ram) return;
        if (addr < RAM_SIZE) ram[addr] = value;
    }

    void write16(uint32_t addr, uint16_t value) override {
        if (!ram) return;
        if (addr + 1 < RAM_SIZE) {
            ram[addr] = value >> 8;
            ram[addr + 1] = value & 0xFF;
        }
    }

    // Helper to write a 16-bit word in big-endian
    void write_word(uint32_t addr, uint16_t value) {
        ram[addr] = value >> 8;
        ram[addr + 1] = value & 0xFF;
    }

    // Helper to write a 32-bit long in big-endian
    void write_long(uint32_t addr, uint32_t value) {
        ram[addr] = value >> 24;
        ram[addr + 1] = (value >> 16) & 0xFF;
        ram[addr + 2] = (value >> 8) & 0xFF;
        ram[addr + 3] = value & 0xFF;
    }

    // Convenience wrappers for public get/set methods
    u32 readD(int n) const { return getD(n); }
    u32 readA(int n) const { return getA(n); }
    void writeD(int n, u32 v) { setD(n, v); }
    void writeA(int n, u32 v) { setA(n, v); }
};
```

## src/test_logical.cpp
```c
/*
 * Logical and Shift Instruction Tests
 * Tests AND, OR, EOR, NOT, TST, CLR, ASL, ASR, LSL, LSR instructions
 */

#include <zephyr/ztest.h>
#include "test_helper.h"

ZTEST_SUITE(logical_instructions, NULL, NULL, NULL, NULL, NULL);

ZTEST(logical_instructions, test_and_dn_dn)
{
    TestMemory cpu;
    cpu.write_long(0, 0x00001000);
    cpu.write_long(4, 0x00000400);
    // Setup: D0 = 0xFF00, D1 = 0x0F0F
    cpu.writeD(0, 0xFF00);
    cpu.writeD(1, 0x0F0F);

    // AND.W D1,D0  (0xC041)
    cpu.write_word(0x400, 0xC041);  // AND.W D1,D0

    cpu.reset();  // Reset AFTER writing instructions
    cpu.execute();

    zassert_equal(cpu.readD(0), 0x0F00, "D0 should contain 0x0F00");
    printk("✓ AND.W D1,D0 test passed\n");
}

ZTEST(logical_instructions, test_and_immediate)
{
    TestMemory cpu;
    cpu.write_long(0, 0x00001000);
    cpu.write_long(4, 0x00000400);
    // Setup: D2 = 0xAAAA
    cpu.writeD(2, 0xAAAA);

    // ANDI.W #0x5555,D2  (0x0242 followed by immediate)
    cpu.write_word(0x400, 0x0242);  // ANDI.W #imm,D2
    cpu.write_word(0x402, 0x5555);  // immediate value

    cpu.reset();  // Reset AFTER writing instructions
    cpu.execute();

    zassert_equal(cpu.readD(2), 0x0000, "D2 should contain 0x0000");
    printk("✓ ANDI.W #0x5555,D2 test passed\n");
}

ZTEST(logical_instructions, test_or_dn_dn)
{
    TestMemory cpu;
    cpu.write_long(0, 0x00001000);
    cpu.write_long(4, 0x00000400);
    // Setup: D0 = 0xF000, D1 = 0x0F00
    cpu.writeD(0, 0xF000);
    cpu.writeD(1, 0x0F00);

    // OR.W D1,D0  (0x8041)
    cpu.write_word(0x400, 0x8041);  // OR.W D1,D0

    cpu.reset();  // Reset AFTER writing instructions
    cpu.execute();

    zassert_equal(cpu.readD(0), 0xFF00, "D0 should contain 0xFF00");
    printk("✓ OR.W D1,D0 test passed\n");
}

ZTEST(logical_instructions, test_or_immediate)
{
    TestMemory cpu;
    cpu.write_long(0, 0x00001000);
    cpu.write_long(4, 0x00000400);
    // Setup: D3 = 0x1000
    cpu.writeD(3, 0x1000);

    // ORI.W #0x0200,D3  (0x0043 followed by immediate)
    cpu.write_word(0x400, 0x0043);  // ORI.W #imm,D3
    cpu.write_word(0x402, 0x0200);  // immediate value

    cpu.reset();  // Reset AFTER writing instructions
    cpu.execute();

    zassert_equal(cpu.readD(3), 0x1200, "D3 should contain 0x1200");
    printk("✓ ORI.W #0x0200,D3 test passed\n");
}

ZTEST(logical_instructions, test_tst_zero)
{
    TestMemory cpu;
    cpu.write_long(0, 0x00001000);
    cpu.write_long(4, 0x00000400);
    // Setup: D0 = 0
    cpu.writeD(0, 0);

    // TST.L D0  (0x4A80)
    cpu.write_word(0x400, 0x4A80);  // TST.L D0

    cpu.reset();  // Reset AFTER writing instructions
    cpu.execute();

    zassert_equal(cpu.readD(0), 0, "D0 should still be 0");
    printk("✓ TST.L D0 (zero) test passed\n");
}

ZTEST(logical_instructions, test_tst_nonzero)
{
    TestMemory cpu;
    cpu.write_long(0, 0x00001000);
    cpu.write_long(4, 0x00000400);
    // Setup: D1 = 42
    cpu.writeD(1, 42);

    // TST.W D1  (0x4A41)
    cpu.write_word(0x400, 0x4A41);  // TST.W D1

    cpu.reset();  // Reset AFTER writing instructions
    cpu.execute();

    zassert_equal(cpu.readD(1), 42, "D1 should still be 42");
    printk("✓ TST.W D1 (nonzero) test passed\n");
}

ZTEST(logical_instructions, test_clr_dn)
{
    TestMemory cpu;
    cpu.write_long(0, 0x00001000);
    cpu.write_long(4, 0x00000400);
    // Setup: D2 = 0x12345678
    cpu.writeD(2, 0x12345678);

    // CLR.L D2  (0x4282)
    cpu.write_word(0x400, 0x4282);  // CLR.L D2

    cpu.reset();  // Reset AFTER writing instructions
    cpu.execute();

    zassert_equal(cpu.readD(2), 0, "D2 should be 0");
    printk("✓ CLR.L D2 test passed\n");
}

ZTEST(logical_instructions, test_asl_immediate)
{
    TestMemory cpu;
    cpu.write_long(0, 0x00001000);
    cpu.write_long(4, 0x00000400);
    // Setup: D0 = 1
    cpu.writeD(0, 1);

    // ASL.W #3,D0  (0xE740) - shift left by 3
    cpu.write_word(0x400, 0xE740);  // ASL.W #3,D0

    cpu.reset();  // Reset AFTER writing instructions
    cpu.execute();

    zassert_equal(cpu.readD(0), 8, "D0 should contain 8");
    printk("✓ ASL.W #3,D0 test passed\n");
}

ZTEST(logical_instructions, test_asr_immediate)
{
    TestMemory cpu;
    cpu.write_long(0, 0x00001000);
    cpu.write_long(4, 0x00000400);
    // Setup: D1 = 16
    cpu.writeD(1, 16);

    // ASR.W #2,D1  (0xE441) - shift right by 2
    cpu.write_word(0x400, 0xE441);  // ASR.W #2,D1

    cpu.reset();  // Reset AFTER writing instructions
    cpu.execute();

    zassert_equal(cpu.readD(1), 4, "D1 should contain 4");
    printk("✓ ASR.W #2,D1 test passed\n");
}

ZTEST(logical_instructions, test_lsl_immediate)
{
    TestMemory cpu;
    cpu.write_long(0, 0x00001000);
    cpu.write_long(4, 0x00000400);
    // Setup: D2 = 0x0001
    cpu.writeD(2, 0x0001);

    // LSL.L #4,D2  (0xE98A) - shift left by 4
    cpu.write_word(0x400, 0xE98A);  // LSL.L #4,D2

    cpu.reset();  // Reset AFTER writing instructions
    cpu.execute();

    zassert_equal(cpu.readD(2), 0x10, "D2 should contain 0x10");
    printk("✓ LSL.L #4,D2 test passed\n");
}

ZTEST(logical_instructions, test_lsr_immediate)
{
    TestMemory cpu;
    cpu.write_long(0, 0x00001000);
    cpu.write_long(4, 0x00000400);
    // Setup: D3 = 0x80
    cpu.writeD(3, 0x80);

    // LSR.W #4,D3  (0xE84B) - shift right by 4
    cpu.write_word(0x400, 0xE84B);  // LSR.W #4,D3

    cpu.reset();  // Reset AFTER writing instructions
    cpu.execute();

    zassert_equal(cpu.readD(3), 0x08, "D3 should contain 0x08");
    printk("✓ LSR.W #4,D3 test passed\n");
}

ZTEST(logical_instructions, test_asl_register)
{
    TestMemory cpu;
    cpu.write_long(0, 0x00001000);
    cpu.write_long(4, 0x00000400);
    // Setup: D0 = 2 (shift count), D1 = 1
    cpu.writeD(0, 2);
    cpu.writeD(1, 1);

    // ASL.W D0,D1  (0xE161) - shift D1 left by D0
    cpu.write_word(0x400, 0xE161);  // ASL.W D0,D1

    cpu.reset();  // Reset AFTER writing instructions
    cpu.execute();

    zassert_equal(cpu.readD(1), 4, "D1 should contain 4");
    printk("✓ ASL.W D0,D1 test passed\n");
}

ZTEST(logical_instructions, test_lsr_register)
{
    TestMemory cpu;
    cpu.write_long(0, 0x00001000);
    cpu.write_long(4, 0x00000400);
    // Setup: D2 = 3 (shift count), D3 = 0x40
    cpu.writeD(2, 3);
    cpu.writeD(3, 0x40);

    // LSR.W D2,D3  (0xE4AB) - shift D3 right by D2
    cpu.write_word(0x400, 0xE4AB);  // LSR.W D2,D3

    cpu.reset();  // Reset AFTER writing instructions
    cpu.execute();

    zassert_equal(cpu.readD(3), 0x08, "D3 should contain 0x08");
    printk("✓ LSR.W D2,D3 test passed\n");
}
```
