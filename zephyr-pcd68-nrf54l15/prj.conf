## CMakeLists.txt
```
# SPDX-License-Identifier: Apache-2.0

cmake_minimum_required(VERSION 3.20.0)

# Include Zephyr boilerplate
find_package(Zephyr REQUIRED HINTS $ENV{ZEPHYR_BASE})
project(pcd68_nrf54l15)

# Include PCD68 common source directory
set(PCD68_SRC_DIR ${CMAKE_CURRENT_SOURCE_DIR}/../src)

# Core PCD68 emulation sources with optimized Moira dispatch
target_sources(app PRIVATE
    src/main.cpp
    ${PCD68_SRC_DIR}/PCD68_CPU.cpp
    ${PCD68_SRC_DIR}/Moira/Moira.cpp
    ${PCD68_SRC_DIR}/Moira/MoiraDebugger.cpp
    # Essential peripherals - optimized for memory
    ${PCD68_SRC_DIR}/TDA.cpp
    ${PCD68_SRC_DIR}/KCTL.cpp
    src/Storage_Zephyr.cpp
    # Screen support
    ${PCD68_SRC_DIR}/Screen.cpp
    src/Screen_Zephyr.cpp
    # UART support
    src/UART_Zephyr.cpp
    # Keyboard input (stub for now - BLE needs API adaptation for nRF54L15)
    src/KeyboardInput_Zephyr.cpp
)

# Include directories
target_include_directories(app PRIVATE
    src
    ${PCD68_SRC_DIR}
    ${PCD68_SRC_DIR}/Moira
)

# Compiler definitions
target_compile_definitions(app PRIVATE
    ZEPHYR_BUILD=1
    USE_ZEPHYR=1
    PCD68_DISABLE_SOUND=1
    CONFIG_PCD68_ROM_SIZE_KB=64
    CONFIG_PCD68_RAM_SIZE_MB=0
    CONFIG_PCD68_TARGET_CPU_MHZ=128
)

# C++ standard and flags
set_property(TARGET app PROPERTY CXX_STANDARD 17)
set_property(TARGET app PROPERTY CXX_STANDARD_REQUIRED ON)
target_compile_options(app PRIVATE $<$<COMPILE_LANGUAGE:CXX>:-std=gnu++17>)
```

## Kconfig
```
# PCD68 nRF54L15 Configuration Options
# SPDX-License-Identifier: Apache-2.0

config PCD68_ROM_SIZE_KB
	int "PCD68 ROM size in KB"
	default 64
	help
	  Size of the 68000 ROM in kilobytes

config PCD68_RAM_SIZE_MB
	int "PCD68 RAM size in MB"
	default 4
	help
	  Size of the 68000 RAM in megabytes

config PCD68_TARGET_CPU_MHZ
	int "Target CPU frequency in MHz"
	default 128
	help
	  Target CPU frequency for timing calculations

config PCD68_EPAPER_DISPLAY
	bool "Enable e-paper display support"
	default y
	depends on DISPLAY
	help
	  Enable support for e-paper display output

config PCD68_DEBUG_TIMING
	bool "Enable timing debug output"
	default n
	help
	  Enable detailed timing debug information

source "Kconfig.zephyr"
```

## west.yml
```
manifest:
  self:
    west-commands: scripts/west_commands.yml

  remotes:
    - name: nrfconnect
      url-base: https://github.com/nrfconnect

  projects:
    - name: zephyr
      remote: nrfconnect
      repo-path: sdk-zephyr
      revision: v3.7.99-ncs1-1
      import:
        # By using name-allowlist we can import only the modules that are
        # strictly needed by this application.
        name-allowlist:
          - cmsis
          - hal_nordic
          - mcuboot
          - mbedtls
          - nrf_hw_models
          - trusted-firmware-m

    - name: mcuboot
      repo-path: sdk-mcuboot
      remote: nrfconnect
      revision: v2.1.99-ncs1-1

    - name: mbedtls
      repo-path: mbedtls
      remote: nrfconnect
      revision: v3.6.0-ncs2-1
```

## prj.conf
```kconfig
# PCD68 nRF54L15 Configuration

# Basic system configuration - reduced for nRF54L15 but with stack protection
CONFIG_MAIN_STACK_SIZE=4096
CONFIG_SYSTEM_WORKQUEUE_STACK_SIZE=1024

# Memory and threading - minimal heap since we use switch dispatch instead of exec table
CONFIG_HEAP_MEM_POOL_SIZE=16384
CONFIG_THREAD_NAME=n
CONFIG_THREAD_STACK_INFO=n

# C++ support - minimal
CONFIG_CPP=y
CONFIG_NEWLIB_LIBC=n
CONFIG_NEWLIB_LIBC_FLOAT_PRINTF=n

# C++ standards
CONFIG_STD_CPP17=y

# Reduce code size
CONFIG_MINIMAL_LIBC=n
CONFIG_PICOLIBC=y
CONFIG_PICOLIBC_IO_C99_FORMATS=n

# Console and logging - minimal for production
CONFIG_CONSOLE=y
CONFIG_UART_CONSOLE=y
CONFIG_SERIAL=y
CONFIG_LOG=n

# Display subsystem for UC8176 e-paper - DISABLED FOR UART DEBUGGING
# CONFIG_DISPLAY=y
# CONFIG_SPI=y
# CONFIG_SPI_ASYNC=y
# CONFIG_MIPI_DBI=y

# GPIO for display control - DISABLED FOR UART DEBUGGING
# CONFIG_GPIO=y

# Optimization settings for nRF54L15 - size optimization but less aggressive compiler flags
CONFIG_SIZE_OPTIMIZATIONS=y
CONFIG_DEBUG_OPTIMIZATIONS=n
CONFIG_DEBUG_THREAD_INFO=n

# Additional memory optimizations for nRF54L15
CONFIG_DYNAMIC_THREAD=n
CONFIG_NET_BUF_POOL_USAGE=n
CONFIG_PRINTK=y
CONFIG_CBPRINTF_FP_SUPPORT=n
CONFIG_USERSPACE=n
CONFIG_ASSERT=n

# Compiler optimizations - size with gentler flags for C++ compatibility
CONFIG_COMPILER_OPT="-Os -fno-aggressive-loop-optimizations"

# Stack protection - enable for debugging C++ issues
CONFIG_STACK_SENTINEL=y

# Flash settings optimized for nRF54L15 RRAM
CONFIG_FLASH=y
CONFIG_FLASH_MAP=y

# Power management
CONFIG_PM=y
CONFIG_PM_DEVICE=y

# Bluetooth (disabled for now to save space)
# CONFIG_BT=n
```

## prj_debug.conf
```kconfig
# PCD68 nRF54L15 Debug Configuration

# Basic system configuration
CONFIG_MAIN_STACK_SIZE=8192
CONFIG_SYSTEM_WORKQUEUE_STACK_SIZE=2048

# Memory and threading
CONFIG_HEAP_MEM_POOL_SIZE=262144
CONFIG_THREAD_NAME=y
CONFIG_THREAD_STACK_INFO=y

# C++ support
CONFIG_CPP=y
CONFIG_NEWLIB_LIBC=y
CONFIG_NEWLIB_LIBC_FLOAT_PRINTF=y

# Console and logging
CONFIG_CONSOLE=y
CONFIG_UART_CONSOLE=y
CONFIG_SERIAL=y
CONFIG_LOG=y
CONFIG_LOG_DEFAULT_LEVEL=4

# Display subsystem for e-paper
CONFIG_DISPLAY=y
CONFIG_SPI=y

# GPIO for display control
CONFIG_GPIO=y

# Debug settings
CONFIG_DEBUG_OPTIMIZATIONS=y
CONFIG_DEBUG_THREAD_INFO=y
CONFIG_ASSERT=y

# PCD68 debug options
CONFIG_PCD68_DEBUG_TIMING=y

# Stack protection
CONFIG_STACK_SENTINEL=y

# Flash settings optimized for nRF54L15 RRAM
CONFIG_FLASH=y
CONFIG_FLASH_MAP=y

# Power management
CONFIG_PM=y
CONFIG_PM_DEVICE=y

# E-paper display support
CONFIG_PCD68_EPAPER_DISPLAY=y
```

## nrf54l15dk_nrf54l15_cpuapp.overlay
```dts
/*
 * Copyright (c) 2025 PCD68 Project
 * SPDX-License-Identifier: Apache-2.0
 */

/ {
    chosen {
        zephyr,console = &uart20;
        zephyr,shell-uart = &uart20;
        zephyr,uart-mcumgr = &uart20;
        zephyr,bt-mon-uart = &uart20;
        zephyr,bt-c2h-uart = &uart20;
        // zephyr,display = &uc8176;  // Disabled for UART debugging
    };

    /* Display configuration disabled to restore UART
    mipi_dbi_uc8176 {
        compatible = "zephyr,mipi-dbi-spi";
        spi-dev = <&spi00>;
        dc-gpios = <&gpio1 11 GPIO_ACTIVE_HIGH>;
        reset-gpios = <&gpio1 12 GPIO_ACTIVE_LOW>;
        write-only;
        #address-cells = <1>;
        #size-cells = <0>;

        uc8176: uc8176@1 {
            compatible = "gooddisplay,gdew042t2", "ultrachip,uc8176";
            mipi-max-frequency = <4000000>;
            reg = <1>;  // Use CS1 (P1.8), not CS0 (P2.5)
            width = <400>;
            height = <300>;
            busy-gpios = <&gpio1 9 GPIO_ACTIVE_LOW>;

            softstart = [17 17 17];

            full {
                pwr = [03 00 26 26 09];
                cdi = <0xd7>;
                tcon = <0x22>;
            };

            partial {
                pwr = [03 00 26 26 09];
                cdi = <0xd7>;
                tcon = <0x22>;
            };
        };
    };
    */
};

/* SPI21 configuration disabled until we fix pinctrl
&spi21 {
    status = "okay";
    cs-gpios = <&gpio1 8 GPIO_ACTIVE_LOW>;
    pinctrl-0 = <&spi21_default>;
    pinctrl-1 = <&spi21_sleep>;
    pinctrl-names = "default", "sleep";
};
*/

/* SPI00 modifications disabled for UART debugging
&spi00 {
    cs-gpios = <&gpio2 5 GPIO_ACTIVE_LOW>, <&gpio1 8 GPIO_ACTIVE_LOW>;
};
*/

/* Flash disabled for UART debugging */
&mx25r64 {
    status = "disabled";
};

/* Leave default partition layout for now to avoid validation errors */

/* TODO: Need to find a way to add SPI21 pins without breaking UART */
```

## src/main.cpp
```c
#include <zephyr/kernel.h>
#include <zephyr/device.h>
#include <zephyr/drivers/display.h>
#include <zephyr/drivers/gpio.h>
#include <zephyr/drivers/spi.h>
#include <zephyr/logging/log.h>
#include <zephyr/sys/printk.h>
#include <zephyr/devicetree.h>

#include "PCD68_CPU.h"
// TODO: Re-enable peripherals after optimizing dispatch
// #include "TDA.h"
// #include "KCTL.h"
// #include "UART.h"
// #include "Screen_Zephyr.h"
// #include "KeyboardInput_Zephyr.h"
#include "Storage_Zephyr.h"
#include "text_demo.h"
#include <new>  // For placement new

// External declarations from text_demo.h
extern unsigned char text_demo_bin[];
extern unsigned int text_demo_bin_len;

LOG_MODULE_REGISTER(pcd68_main, CONFIG_LOG_DEFAULT_LEVEL);

// Global static CPU object
static CPU global_cpu;

// Global emulator components
unsigned char* systemRom = nullptr;
unsigned char* systemRam = nullptr;
// Use dynamic allocation - static allocation is 544KB which exceeds available RAM
static CPU* pcdCpu = nullptr;
// TODO: Re-enable after Musashi migration
// static TDA* textDisplayAdapter = nullptr;
// static KCTL* keyboardController = nullptr;
// static UART* uartController = nullptr;
// TODO: Re-enable after Musashi migration
// static Screen_Zephyr pcdScreenStatic(0x810000);
// static Screen_Zephyr* pcdScreen = &pcdScreenStatic;
// static KeyboardInput_Zephyr* keyboardInput = nullptr;
static Storage_Zephyr* storage = nullptr;

// Emulation timing for nRF54L15 (128MHz)
static uint32_t cycles_per_iteration = 1000;
static uint32_t target_cpu_hz = CONFIG_PCD68_TARGET_CPU_MHZ * 1000000;
static uint32_t iteration_delay_us = (cycles_per_iteration * 1000000) / target_cpu_hz;

// Thread stacks - reduced for nRF54L15 256KB RAM
K_THREAD_STACK_DEFINE(emulation_stack, 2048);
K_THREAD_STACK_DEFINE(display_stack, 1024);
K_THREAD_STACK_DEFINE(input_stack, 1024);

struct k_thread emulation_thread;
struct k_thread display_thread;
struct k_thread input_thread;

// Synchronization
K_SEM_DEFINE(display_sem, 0, 1);
K_MUTEX_DEFINE(cpu_mutex);

// Display refresh rate for e-paper (lower refresh for power savings)
#define DISPLAY_REFRESH_RATE 10
#define DISPLAY_REFRESH_MS (1000 / DISPLAY_REFRESH_RATE)

// Forward declarations
void emulation_thread_entry(void *p1, void *p2, void *p3);
void display_thread_entry(void *p1, void *p2, void *p3);
void input_thread_entry(void *p1, void *p2, void *p3);
static void test_display_splash(const struct device *display_dev);

static int init_hardware(void)
{
    LOG_INF("Initializing hardware for PCD68 on nRF54L15");

#ifdef CONFIG_PCD68_EPAPER_DISPLAY
    const struct device *display_dev = DEVICE_DT_GET(DT_CHOSEN(zephyr_display));
    if (!device_is_ready(display_dev)) {
        LOG_WRN("E-paper display not ready, continuing without display");
    } else {
        LOG_INF("E-paper display initialized successfully");

        // Show boot splash screen to test display
        test_display_splash(display_dev);
    }
#else
    LOG_INF("Display support disabled");
#endif

    return 0;
}

static void test_display_splash(const struct device *display_dev)
{
    LOG_INF("Starting e-paper display test - this should appear in UART");
    printk("DISPLAY TEST: Starting e-paper display boot splash test\n");

    // Test GPIO and SPI access to verify hardware setup
    printk("DISPLAY TEST: Testing GPIO and SPI device access...\n");
    const struct device *gpio1 = DEVICE_DT_GET(DT_NODELABEL(gpio1));
    const struct device *gpio2 = DEVICE_DT_GET(DT_NODELABEL(gpio2));
    const struct device *spi00 = DEVICE_DT_GET(DT_NODELABEL(spi00));

    if (!device_is_ready(gpio1)) {
        printk("DISPLAY TEST: GPIO1 device not ready!\n");
    } else {
        printk("DISPLAY TEST: GPIO1 device ready\n");
    }

    if (!device_is_ready(gpio2)) {
        printk("DISPLAY TEST: GPIO2 device not ready!\n");
    } else {
        printk("DISPLAY TEST: GPIO2 device ready\n");
    }

    if (!device_is_ready(spi00)) {
        printk("DISPLAY TEST: SPI00 device not ready!\n");
    } else {
        printk("DISPLAY TEST: SPI00 device ready\n");
    }

    printk("DISPLAY TEST: Expected pin assignments:\n");
    printk("DISPLAY TEST: SPI00 - SCK:P2.1, MOSI:P2.2\n");
    printk("DISPLAY TEST: Flash CS0:P2.5 (disabled), Display CS1:P1.8\n");
    printk("DISPLAY TEST: Display - DC:P1.6, RST:P1.7, BUSY:P1.9\n");

    // Test the BUSY pin (GPIO1.9) manually
    printk("DISPLAY TEST: Testing BUSY pin (GPIO1.9)...\n");
    if (device_is_ready(gpio1)) {
        // Configure BUSY pin as input
        int ret = gpio_pin_configure(gpio1, 9, GPIO_INPUT);
        if (ret == 0) {
            int busy_val = gpio_pin_get(gpio1, 9);
            printk("DISPLAY TEST: BUSY pin current value: %d (0=busy, 1=ready)\n", busy_val);
        } else {
            printk("DISPLAY TEST: Failed to configure BUSY pin: %d\n", ret);
        }
    }

    // Get display capabilities
    struct display_capabilities caps;
    display_get_capabilities(display_dev, &caps);

    LOG_INF("Display: %dx%d, pixel format: %d", caps.x_resolution, caps.y_resolution, caps.current_pixel_format);
    printk("DISPLAY TEST: Display capabilities - %dx%d, supported formats: 0x%x, current: %d\n",
           caps.x_resolution, caps.y_resolution, caps.supported_pixel_formats, caps.current_pixel_format);

    // Try to explicitly set pixel format to MONO10
    if (caps.supported_pixel_formats & PIXEL_FORMAT_MONO10) {
        printk("DISPLAY TEST: Setting pixel format to MONO10\n");
        int fmt_ret = display_set_pixel_format(display_dev, PIXEL_FORMAT_MONO10);
        if (fmt_ret != 0) {
            printk("DISPLAY TEST: Failed to set MONO10 format: %d\n", fmt_ret);
        }
    } else if (caps.supported_pixel_formats & PIXEL_FORMAT_MONO01) {
        printk("DISPLAY TEST: Setting pixel format to MONO01\n");
        int fmt_ret = display_set_pixel_format(display_dev, PIXEL_FORMAT_MONO01);
        if (fmt_ret != 0) {
            printk("DISPLAY TEST: Failed to set MONO01 format: %d\n", fmt_ret);
        }
    }

    // Create a simple test pattern
    size_t buffer_size = caps.x_resolution * caps.y_resolution / 8;  // Packed monochrome
    u8 *test_buffer = new u8[buffer_size];
    if (!test_buffer) {
        LOG_ERR("Failed to allocate test buffer");
        return;
    }

    // Create a very obvious test pattern with both normal and inverted data
    printk("DISPLAY TEST: Creating test pattern - pixel format: %d\n", caps.current_pixel_format);

    // Pattern 1: Quarters - try different combinations
    memset(test_buffer, 0x00, buffer_size / 4);                    // Quarter 1: All black (0x00)
    memset(test_buffer + buffer_size / 4, 0xFF, buffer_size / 4);  // Quarter 2: All white (0xFF)
    memset(test_buffer + buffer_size / 2, 0xAA, buffer_size / 4);  // Quarter 3: Alternating (0xAA)
    memset(test_buffer + 3 * buffer_size / 4, 0x55, buffer_size / 4); // Quarter 4: Inverted alternating (0x55)

    printk("DISPLAY TEST: Pattern created - Q1:0x00, Q2:0xFF, Q3:0xAA, Q4:0x55\n");

    // Write to display
    struct display_buffer_descriptor desc = {
        .buf_size = buffer_size,
        .width = caps.x_resolution,
        .height = caps.y_resolution,
        .pitch = caps.x_resolution / 8,
    };

    // Make sure display is on
    printk("DISPLAY TEST: Turning off display blanking...\n");
    int blank_ret = display_blanking_off(display_dev);
    if (blank_ret != 0) {
        printk("DISPLAY TEST: Failed to turn off blanking: %d\n", blank_ret);
    } else {
        printk("DISPLAY TEST: Display blanking turned off successfully\n");
    }

    // Add a small delay for e-paper initialization
    k_msleep(100);

    printk("DISPLAY TEST: About to write to display...\n");
    int ret = display_write(display_dev, 0, 0, &desc, test_buffer);
    if (ret == 0) {
        LOG_INF("Boot splash displayed successfully");
        printk("DISPLAY TEST: Boot splash written successfully!\n");

        // Check if busy pin is working during display operation
        printk("DISPLAY TEST: Monitoring BUSY pin during display operation...\n");
        if (device_is_ready(gpio1)) {
            int busy_before = gpio_pin_get(gpio1, 9);
            printk("DISPLAY TEST: BUSY pin before write: %d\n", busy_before);
        }
        k_msleep(100);

        // Try blanking on then off to force refresh
        printk("DISPLAY TEST: Toggling display blanking to force refresh...\n");
        display_blanking_on(display_dev);
        k_msleep(100);
        display_blanking_off(display_dev);

        // Try explicit display update for e-paper
        printk("DISPLAY TEST: Attempting explicit display update...\n");
        int update_ret = display_write(display_dev, 0, 0, &desc, test_buffer);
        if (update_ret == 0) {
            printk("DISPLAY TEST: Second write for update successful\n");
        } else {
            printk("DISPLAY TEST: Second write failed: %d\n", update_ret);
        }

        // Give e-paper time to process and monitor BUSY pin
        printk("DISPLAY TEST: Waiting 5 seconds for e-paper to update...\n");
        for (int i = 0; i < 10; i++) {
            if (device_is_ready(gpio1)) {
                int busy_val = gpio_pin_get(gpio1, 9);
                printk("DISPLAY TEST: BUSY pin after %d seconds: %d\n", i/2, busy_val);
            }
            k_msleep(500);
        }
        printk("DISPLAY TEST: Should see 4-quarter pattern on display now!\n");
        printk("DISPLAY TEST: Expected pattern - Top-left:black, Top-right:white, Bottom-left:checkered, Bottom-right:inverted-checkered\n");
        printk("DISPLAY TEST: If no display output, check VCC power (3.3V) to display!\n");
    } else {
        LOG_ERR("Failed to display boot splash: %d", ret);
        printk("DISPLAY TEST: Boot splash write FAILED with error %d\n", ret);
    }

    delete[] test_buffer;
}

static int init_storage(void)
{
    LOG_INF("Initializing storage");

    storage = new Storage_Zephyr();
    if (!storage->init()) {
        LOG_ERR("Failed to initialize storage");
        return -EIO;
    }

    return 0;
}

static int load_rom(const char *rom_filename)
{
    LOG_INF("Loading ROM: %s", rom_filename);
    printk("DEBUG: Entering load_rom()\n");

    // Point directly to the embedded text_demo ROM - no copying needed!
    systemRom = (unsigned char*)text_demo_bin;
    size_t rom_size = text_demo_bin_len;
    printk("DEBUG: Using embedded ROM directly: %zu bytes\n", rom_size);

    // Log first few bytes to verify loading
    printk("ROM first 16 bytes: %02x %02x %02x %02x %02x %02x %02x %02x %02x %02x %02x %02x %02x %02x %02x %02x\n",
           systemRom[0], systemRom[1], systemRom[2], systemRom[3],
           systemRom[4], systemRom[5], systemRom[6], systemRom[7],
           systemRom[8], systemRom[9], systemRom[10], systemRom[11],
           systemRom[12], systemRom[13], systemRom[14], systemRom[15]);

    return 0;
}

static int init_emulator(void)
{
    LOG_INF("Initializing PCD68 emulator components");
    printk("DEBUG: Starting init_hardware()\n");

    // Use static allocation for emulated RAM - much better for embedded
    static unsigned char static_ram[32 * 1024];  // 32KB statically allocated to fit in RAM
    systemRam = static_ram;
    size_t ram_size = sizeof(static_ram);

    printk("DEBUG: Using %zu bytes static RAM\n", ram_size);
    memset(systemRam, 0, ram_size);
    printk("DEBUG: Static RAM initialized successfully\n");

    // Load ROM
    printk("DEBUG: Loading ROM\n");
    int ret = load_rom("program.bin");
    if (ret < 0) {
        printk("ERROR: ROM loading failed!\n");
        return ret;
    }
    printk("DEBUG: ROM loaded successfully\n");

    // Use global static CPU object (avoids dynamic allocation)
    printk("DEBUG: Creating Musashi CPU object...\n");
    printk("DEBUG: CPU object size: %zu bytes\n", sizeof(CPU));

    pcdCpu = &global_cpu;
    printk("DEBUG: Musashi CPU created successfully!\n");

    // TODO: Re-enable screen after Musashi migration
    printk("DEBUG: Skipping screen creation during Musashi migration\n");

    // TODO: Create minimal peripherals after Musashi migration complete
    printk("DEBUG: Skipping peripheral creation during Musashi migration\n");

    // TODO: Re-enable keyboard input after Musashi migration
    printk("DEBUG: Skipping keyboard input setup during Musashi migration\n");

    // Skip ALL peripheral attachments for initial 68000 core testing
    printk("DEBUG: Skipping ALL peripheral attachments due to memory constraints\n");
    printk("DEBUG: This will test pure 68000 CPU execution without peripherals\n");

    // Test memory access before CPU reset
    printk("DEBUG: Testing ROM access...\n");
    printk("DEBUG: ROM[0]=0x%02X ROM[1]=0x%02X ROM[2]=0x%02X ROM[3]=0x%02X\n",
           systemRom[0], systemRom[1], systemRom[2], systemRom[3]);
    printk("DEBUG: Testing RAM access...\n");
    systemRam[0] = 0xAA;
    systemRam[1] = 0x55;
    printk("DEBUG: RAM test write/read: wrote 0xAA55, read 0x%02X%02X\n",
           systemRam[0], systemRam[1]);

    // Try calling reset() now that we have a properly allocated CPU object
    printk("DEBUG: Calling CPU reset() with properly allocated object...\n");

    // Read initial stack pointer and program counter from ROM vector table
    // 68000 vector table: 0x0-0x3 = initial SSP, 0x4-0x7 = initial PC
    uint32_t initial_ssp = (systemRom[0] << 24) | (systemRom[1] << 16) |
                          (systemRom[2] << 8) | systemRom[3];
    uint32_t initial_pc = (systemRom[4] << 24) | (systemRom[5] << 16) |
                         (systemRom[6] << 8) | systemRom[7];

    printk("DEBUG: ROM vector table - SSP=0x%08X PC=0x%08X\n", initial_ssp, initial_pc);

    // Create a bootstrap program that will set the CPU state properly
    printk("DEBUG: Creating bootstrap program to initialize CPU state\n");

    // Save original ROM bytes
    uint8_t original_rom[16];
    memcpy(original_rom, systemRom, 16);

    // Create bootstrap code that sets SP and jumps to main program
    // 68000 assembly:
    // move.l #0x00BFFFFF, sp    ; Set stack pointer
    // jmp 0x1000               ; Jump to main program

    // Bootstrap vector table (temporary)
    // Stack at end of 32KB RAM: 0x010000 + 0x8000 = 0x018000
    systemRom[0] = 0x00; systemRom[1] = 0x01; systemRom[2] = 0x80; systemRom[3] = 0x00; // SSP = 0x018000
    systemRom[4] = 0x00; systemRom[5] = 0x00; systemRom[6] = 0x00; systemRom[7] = 0x10; // PC = 0x10 (bootstrap code)

    // Bootstrap code at address 0x10:
    // move.l #0x00018000, sp (0x2E7C 0x00018000)
    systemRom[0x10] = 0x2E; systemRom[0x11] = 0x7C;  // move.l #imm32, sp
    systemRom[0x12] = 0x00; systemRom[0x13] = 0x01;  // 0x00018000
    systemRom[0x14] = 0x80; systemRom[0x15] = 0x00;

    // jmp 0x1000 (0x4EF9 0x00001000)
    systemRom[0x16] = 0x4E; systemRom[0x17] = 0xF9;  // jmp absolute
    systemRom[0x18] = 0x00; systemRom[0x19] = 0x00;  // 0x00001000
    systemRom[0x1A] = 0x10; systemRom[0x1B] = 0x00;

    printk("DEBUG: Bootstrap program created - will set SP and jump to 0x1000\n");

    // Debug: Print the actual ROM values at vector positions
    printk("DEBUG: ROM vector table before reset:\n");
    printk("  [0x00-0x03] SSP: %02X %02X %02X %02X\n",
           systemRom[0], systemRom[1], systemRom[2], systemRom[3]);
    printk("  [0x04-0x07] PC:  %02X %02X %02X %02X\n",
           systemRom[4], systemRom[5], systemRom[6], systemRom[7]);
    printk("  [0x10-0x15] Bootstrap: %02X %02X %02X %02X %02X %02X\n",
           systemRom[0x10], systemRom[0x11], systemRom[0x12],
           systemRom[0x13], systemRom[0x14], systemRom[0x15]);

    // Now attempt a real CPU reset with the bootstrap ROM
    printk("DEBUG: Attempting CPU reset() with statically allocated object...\n");

    pcdCpu->reset();

    printk("DEBUG: CPU reset() completed successfully!\n");

    // Verify the CPU state after reset
    uint32_t pc = pcdCpu->getPC();
    uint32_t sp = pcdCpu->getSP();

    printk("DEBUG: After reset - PC=0x%08X SP=0x%08X\n", pc, sp);

    // The reset() function should have initialized everything properly
    // No need for manual prefetch queue initialization

    printk("DEBUG: CPU initialization completed!\n");
    printk("CPU STATE: PC=0x%08X SP=0x%08X\n",
           pcdCpu->getPC(), pcdCpu->getSP());

    printk("DEBUG: Emulator initialized successfully\n");
    printk("DEBUG: About to return from init_emulator()\n");
    return 0;
}

void emulation_thread_entry(void *p1, void *p2, void *p3)
{
    ARG_UNUSED(p1);
    ARG_UNUSED(p2);
    ARG_UNUSED(p3);

    LOG_INF("Emulation thread started");
    printk("EMULATION THREAD: Starting 68000 execution loop\n");

    uint32_t last_time = k_uptime_get_32();
    uint32_t cycles_executed = 0;
    uint32_t loop_count = 0;

    // Initial status check - avoid calling methods that might hang
    printk("EMULATION THREAD: Starting without initial CPU state check to avoid hangs\n");
    printk("EMULATION THREAD: Will check CPU state after first execute() call\n");

    while (1) {
        k_mutex_lock(&cpu_mutex, K_FOREVER);

        // Debug CPU state before execute() call
        uint32_t pc_value = pcdCpu->getPC();

        printk("DEBUG: Before execute() - PC=0x%08X\n", pc_value);

        // Check if values look correct
        if (pc_value != 0x00001000) {
            printk("WARNING: PC value incorrect, expected 0x00001000, got 0x%08X\n", pc_value);
        }

        printk("DEBUG: PC value looks valid, calling execute()...\n");

        // Execute CPU cycles using Moira
        pcdCpu->execute();
        cycles_executed += cycles_per_iteration;

        printk("DEBUG: execute() completed successfully!\n");

        k_mutex_unlock(&cpu_mutex);

        loop_count++;

        // More frequent status updates initially (every 1000 loops)
        if (loop_count % 1000 == 0) {
            printk("LOOP %u: Emulation thread running (avoiding CPU state calls for now)\n", loop_count);
        }

        // Yield to other threads
        k_yield();

        // Periodic status - using printk since LOG is disabled
        uint32_t now = k_uptime_get_32();
        if (now - last_time >= 3000) {  // Every 3 seconds
            printk("CPU STATUS: Cycles=%u Loops=%u Uptime=%u ms (CPU state calls disabled)\n",
                   cycles_executed, loop_count, now);
            cycles_executed = 0;
            last_time = now;
        }
    }
}

void display_thread_entry(void *p1, void *p2, void *p3)
{
    ARG_UNUSED(p1);
    ARG_UNUSED(p2);
    ARG_UNUSED(p3);

    LOG_INF("Display thread started (disabled during Musashi migration)");

    while (1) {
        // TODO: Re-enable display refresh after Musashi migration
        k_msleep(DISPLAY_REFRESH_MS);
    }
}

void input_thread_entry(void *p1, void *p2, void *p3)
{
    ARG_UNUSED(p1);
    ARG_UNUSED(p2);
    ARG_UNUSED(p3);

    LOG_INF("Input thread started (disabled during Musashi migration)");

    while (1) {
        // TODO: Re-enable keyboard input polling after Musashi migration
        k_msleep(100);
    }
}

int main(void)
{
    printk("PCD68 CyberTerminal for nRF54L15\n");
    printk("ROM: %dKB, RAM: 64KB, CPU: %dMHz\n",
           CONFIG_PCD68_ROM_SIZE_KB, CONFIG_PCD68_TARGET_CPU_MHZ);
    printk("E-paper display: 400x300 B/W\n");

    // Initialize hardware
    int ret = init_hardware();
    if (ret < 0) {
        LOG_ERR("Hardware initialization failed: %d", ret);
        return ret;
    }

    // Initialize storage
    ret = init_storage();
    if (ret < 0) {
        LOG_ERR("Storage initialization failed: %d", ret);
        return ret;
    }

    // Initialize emulator components
    ret = init_emulator();
    if (ret < 0) {
        LOG_ERR("Emulator initialization failed: %d", ret);
        return ret;
    }

    // Create threads
    printk("DEBUG: Creating emulation thread...\n");
    k_tid_t emulation_tid = k_thread_create(&emulation_thread,
                                            emulation_stack,
                                            K_THREAD_STACK_SIZEOF(emulation_stack),
                                            emulation_thread_entry,
                                            NULL, NULL, NULL,
                                            K_PRIO_PREEMPT(5),
                                            0, K_NO_WAIT);
    k_thread_name_set(emulation_tid, "pcd68_cpu");
    printk("DEBUG: Emulation thread created successfully\n");

    k_tid_t display_tid = k_thread_create(&display_thread,
                                          display_stack,
                                          K_THREAD_STACK_SIZEOF(display_stack),
                                          display_thread_entry,
                                          NULL, NULL, NULL,
                                          K_PRIO_PREEMPT(7),
                                          0, K_NO_WAIT);
    k_thread_name_set(display_tid, "pcd68_display");

    k_tid_t input_tid = k_thread_create(&input_thread,
                                        input_stack,
                                        K_THREAD_STACK_SIZEOF(input_stack),
                                        input_thread_entry,
                                        NULL, NULL, NULL,
                                        K_PRIO_PREEMPT(6),
                                        0, K_NO_WAIT);
    k_thread_name_set(input_tid, "pcd68_input");

    LOG_INF("PCD68 emulation started on nRF54L15");
    printk("PCD68 running - press keys to interact\n");

    // Main thread becomes a monitor/heartbeat
    int counter = 0;
    while (1) {
        k_sleep(K_SECONDS(15));
        counter++;
        LOG_INF("System heartbeat %d - uptime: %u ms", counter, k_uptime_get_32());
    }

    return 0;
}
```

## src/KeyboardInput_BLE.cpp
```c
#include "KeyboardInput_BLE.h"
#include "KCTL.h"
#include <zephyr/logging/log.h>
#include <zephyr/settings/settings.h>

LOG_MODULE_DECLARE(pcd68_main);

// Static instance for callbacks
KeyboardInput_BLE* KeyboardInput_BLE::instance = nullptr;

// HID keycode to ASCII mapping (same as Zephyr version)
const uint8_t KeyboardInput_BLE::hid_to_ascii[256] = {
    0, 0, 0, 0,           // 0x00-0x03: Reserved
    'a', 'b', 'c', 'd',   // 0x04-0x07: A-D
    'e', 'f', 'g', 'h',   // 0x08-0x0B: E-H
    'i', 'j', 'k', 'l',   // 0x0C-0x0F: I-L
    'm', 'n', 'o', 'p',   // 0x10-0x13: M-P
    'q', 'r', 's', 't',   // 0x14-0x17: Q-T
    'u', 'v', 'w', 'x',   // 0x18-0x1B: U-X
    'y', 'z',             // 0x1C-0x1D: Y-Z
    '1', '2', '3', '4',   // 0x1E-0x21: 1-4
    '5', '6', '7', '8',   // 0x22-0x25: 5-8
    '9', '0',             // 0x26-0x27: 9-0
    '\r', '\x1B', '\b',   // 0x28-0x2A: Enter, Escape, Backspace
    '\t', ' ',            // 0x2B-0x2C: Tab, Space
    '-', '=',             // 0x2D-0x2E: - =
    '[', ']',             // 0x2F-0x30: [ ]
    '\\', 0,              // 0x31-0x32: \ (non-US)
    ';', '\'',            // 0x33-0x34: ; '
    '`',                  // 0x35: `
    ',', '.', '/',        // 0x36-0x38: , . /
    0,                    // 0x39: Caps Lock
    0, 0, 0, 0, 0, 0, 0, 0, 0, 0, 0, 0,  // 0x3A-0x45: F1-F12
    0, 0, 0,              // 0x46-0x48: Print Screen, Scroll Lock, Pause
    0, 0, 0,              // 0x49-0x4B: Insert, Home, Page Up
    0, 0, 0,              // 0x4C-0x4E: Delete, End, Page Down
    0, 0, 0, 0,           // 0x4F-0x52: Arrow keys
    0,                    // 0x53: Num Lock
    '/', '*', '-', '+',   // 0x54-0x57: Keypad operators
    '\r',                 // 0x58: Keypad Enter
    '1', '2', '3', '4',   // 0x59-0x5C: Keypad 1-4
    '5', '6', '7', '8',   // 0x5D-0x60: Keypad 5-8
    '9', '0', '.',        // 0x61-0x63: Keypad 9, 0, .
    // Rest initialized to 0
};

// Forward declaration for scan callbacks
extern "C" {
    static void scan_filter_match_wrapper(struct bt_scan_device_info *device_info,
                                         struct bt_scan_filter_match *filter_match,
                                         bool connectable);
    static void scan_filter_no_match_wrapper(struct bt_scan_device_info *device_info,
                                            bool connectable);
    static void scan_connecting_error_wrapper(struct bt_scan_device_info *device_info);
    static void scan_connecting_wrapper(struct bt_scan_device_info *device_info,
                                       struct bt_conn *conn);
}

// C wrapper functions for connection callbacks
extern "C" {
    static void connected_cb_wrapper(struct bt_conn *conn, uint8_t err) {
        KeyboardInput_BLE::connected_cb(conn, err);
    }
    
    static void disconnected_cb_wrapper(struct bt_conn *conn, uint8_t reason) {
        KeyboardInput_BLE::disconnected_cb(conn, reason);
    }
}

// Connection callbacks
BT_CONN_CB_DEFINE(conn_callbacks) = {
    .connected = connected_cb_wrapper,
    .disconnected = disconnected_cb_wrapper,
};

// C wrapper functions for scan callbacks
static void scan_filter_match_wrapper(struct bt_scan_device_info *device_info,
                                     struct bt_scan_filter_match *filter_match,
                                     bool connectable) {
    KeyboardInput_BLE::scan_filter_match(device_info, filter_match, connectable);
}

static void scan_filter_no_match_wrapper(struct bt_scan_device_info *device_info,
                                        bool connectable) {
    KeyboardInput_BLE::scan_filter_no_match(device_info, connectable);
}

static void scan_connecting_error_wrapper(struct bt_scan_device_info *device_info) {
    KeyboardInput_BLE::scan_connecting_error(device_info);
}

static void scan_connecting_wrapper(struct bt_scan_device_info *device_info,
                                   struct bt_conn *conn) {
    KeyboardInput_BLE::scan_connecting(device_info, conn);
}

// Scan callbacks using Nordic SDK macro
BT_SCAN_CB_INIT(scan_cb, scan_filter_match_wrapper, scan_filter_no_match_wrapper,
                scan_connecting_error_wrapper, scan_connecting_wrapper);

KeyboardInput_BLE::KeyboardInput_BLE()
    : keyboardController(nullptr), current_conn(nullptr),
      scanning(false), connected(false), ready(false)
{
    memset(&current_report, 0, sizeof(current_report));
    memset(&hogp_client, 0, sizeof(hogp_client));
    instance = this;
}

KeyboardInput_BLE::~KeyboardInput_BLE()
{
    if (current_conn) {
        bt_conn_disconnect(current_conn, BT_HCI_ERR_REMOTE_USER_TERM_CONN);
    }
    instance = nullptr;
}

int KeyboardInput_BLE::init()
{
    LOG_INF("Initializing BLE GATT HID keyboard host");
    
    int err;
    
    // Initialize Bluetooth
    err = bt_enable(NULL);
    if (err) {
        LOG_ERR("Bluetooth init failed (err %d)", err);
        return err;
    }
    
    LOG_INF("Bluetooth initialized");
    
    // Load settings
    if (IS_ENABLED(CONFIG_SETTINGS)) {
        settings_load();
    }
    
    // Initialize HOGP client with init params structure
    struct bt_hogp_init_params hogp_params = {
        .ready_cb = hogp_ready_cb,
        .pm_update_cb = hogp_pm_update_cb,
    };
    bt_hogp_init(&hogp_client, &hogp_params);
    LOG_INF("HOGP client initialized");
    
    // Initialize scanning  
    struct bt_scan_init_param scan_init = {
        .scan_param = NULL,
        .connect_if_match = 1,
        .conn_param = NULL  // Use default connection parameters
    };
    bt_scan_init(&scan_init);
    bt_scan_cb_register(&scan_cb);
    
    // Scan filters disabled to save space
    /*
    err = bt_scan_filter_add(BT_SCAN_FILTER_TYPE_UUID, BT_UUID_HIDS);
    if (err) {
        LOG_ERR("Scanning filters cannot be set (err %d)", err);
        return err;
    }
    
    err = bt_scan_filter_enable(BT_SCAN_UUID_FILTER, false);
    if (err) {
        LOG_ERR("Cannot enable scan filters (err %d)", err);
        return err;
    }
    */
    
    // Start scanning for HID devices
    scan_start();
    
    LOG_INF("BLE keyboard input initialized, scanning for devices...");
    return 0;
}

bool KeyboardInput_BLE::poll()
{
    // BLE operations are event-driven, so polling is minimal
    // We could check connection status or handle reconnection here
    
    if (!connected && !scanning) {
        // Restart scanning if disconnected
        LOG_INF("Restarting scan for HID devices");
        scan_start();
    }
    return true; // Always continue running
}

uint8_t KeyboardInput_BLE::asciiToHID(char ascii)
{
    // Simple ASCII to HID conversion (implement as needed)
    if (ascii >= 'a' && ascii <= 'z') {
        return 0x04 + (ascii - 'a');  // A-Z keys
    }
    if (ascii >= '1' && ascii <= '9') {
        return 0x1E + (ascii - '1');  // 1-9 keys
    }
    if (ascii == '0') return 0x27;
    if (ascii == ' ') return 0x2C;
    if (ascii == '\r' || ascii == '\n') return 0x28;
    if (ascii == '\t') return 0x2B;
    if (ascii == '\b') return 0x2A;
    
    return 0;  // Unknown key
}

char KeyboardInput_BLE::hidToAscii(uint8_t hid)
{
    if (hid < 256) {
        return hid_to_ascii[hid];
    }
    return 0;
}

// Static callback methods
void KeyboardInput_BLE::scan_start()
{
    int err = bt_scan_start(BT_SCAN_TYPE_SCAN_ACTIVE);
    if (err) {
        LOG_ERR("Scanning failed to start (err %d)", err);
    } else {
        LOG_INF("Scanning for HID devices...");
        if (instance) {
            instance->scanning = true;
        }
    }
}

void KeyboardInput_BLE::scan_filter_match(struct bt_scan_device_info *device_info,
                                         struct bt_scan_filter_match *filter_match,
                                         bool connectable)
{
    char addr[BT_ADDR_LE_STR_LEN];
    bt_addr_le_to_str(device_info->recv_info->addr, addr, sizeof(addr));
    
    LOG_INF("HID device found: %s (RSSI %d)", addr, device_info->recv_info->rssi);
    
    // Stop scanning and connect to the first HID device found
    bt_scan_stop();
    if (instance) {
        instance->scanning = false;
    }
    
    LOG_INF("HID keyboard found, connection will be initiated automatically");
}

void KeyboardInput_BLE::scan_filter_no_match(struct bt_scan_device_info *device_info,
                                            bool connectable)
{
    // We can optionally log non-HID devices found
    // For now, just ignore them
}

void KeyboardInput_BLE::scan_connecting_error(struct bt_scan_device_info *device_info)
{
    LOG_WRN("Connection to HID device failed");
    scan_start();  // Restart scanning
}

void KeyboardInput_BLE::scan_connecting(struct bt_scan_device_info *device_info,
                                       struct bt_conn *conn)
{
    LOG_INF("Connecting to HID device...");
    if (instance && !instance->current_conn) {
        instance->current_conn = bt_conn_ref(conn);
    }
}

void KeyboardInput_BLE::connected_cb(struct bt_conn *conn, uint8_t err)
{
    char addr[BT_ADDR_LE_STR_LEN];
    bt_addr_le_to_str(bt_conn_get_dst(conn), addr, sizeof(addr));
    
    if (err) {
        LOG_ERR("Failed to connect to %s (err %d)", addr, err);
        scan_start();  // Restart scanning
        return;
    }
    
    LOG_INF("Connected to HID device: %s", addr);
    
    if (instance) {
        instance->current_conn = bt_conn_ref(conn);
        instance->connected = true;
        instance->scanning = false;
        
        // Set security and start GATT discovery - security temporarily disabled
        // int err = bt_conn_set_security(conn, BT_SECURITY_L2);
        // if (err) {
        //     LOG_ERR("Failed to set security: %d", err);
        gatt_discover(conn);
        // }
    }
}

void KeyboardInput_BLE::disconnected_cb(struct bt_conn *conn, uint8_t reason)
{
    char addr[BT_ADDR_LE_STR_LEN];
    bt_addr_le_to_str(bt_conn_get_dst(conn), addr, sizeof(addr));
    
    LOG_INF("Disconnected from HID device %s (reason %d)", addr, reason);
    
    if (instance && instance->current_conn == conn) {
        // Release HOGP client if active
        if (bt_hogp_assign_check(&instance->hogp_client)) {
            LOG_INF("HIDS client active - releasing");
            bt_hogp_release(&instance->hogp_client);
        }
        
        bt_conn_unref(instance->current_conn);
        instance->current_conn = nullptr;
        instance->connected = false;
        instance->ready = false;
        
        // Restart scanning for new devices
        int err = bt_scan_start(BT_SCAN_TYPE_SCAN_ACTIVE);
        if (err) {
            LOG_ERR("Scanning failed to start (err %d)", err);
        }
    }
}

void KeyboardInput_BLE::security_changed_cb(struct bt_conn *conn, bt_security_t level,
                                           enum bt_security_err err)
{
    char addr[BT_ADDR_LE_STR_LEN];
    bt_addr_le_to_str(bt_conn_get_dst(conn), addr, sizeof(addr));
    
    if (!err) {
        LOG_INF("Security changed: %s level %u", addr, level);
    } else {
        LOG_WRN("Security failed: %s level %u err %d", addr, level, err);
    }
    
    gatt_discover(conn);
}

// GATT Discovery callbacks
void KeyboardInput_BLE::discovery_completed_cb(struct bt_gatt_dm *dm, void *context)
{
    LOG_INF("GATT discovery completed");
    
    if (instance) {
        int err = bt_hogp_handles_assign(dm, &instance->hogp_client);
        if (err) {
            LOG_ERR("Could not init HOGP client object, error: %d", err);
        }
        
        err = bt_gatt_dm_data_release(dm);
        if (err) {
            LOG_ERR("Could not release the discovery data, error: %d", err);
        }
    }
}

void KeyboardInput_BLE::discovery_service_not_found_cb(struct bt_conn *conn, void *context)
{
    LOG_WRN("HIDS service not found");
}

void KeyboardInput_BLE::discovery_error_found_cb(struct bt_conn *conn, int err, void *context)
{
    LOG_ERR("Discovery procedure failed with %d", err);
}

void KeyboardInput_BLE::gatt_discover(struct bt_conn *conn)
{
    if (!instance || !instance->current_conn || conn != instance->current_conn) {
        return;
    }
    
    static const struct bt_gatt_dm_cb discovery_cb = {
        .completed = discovery_completed_cb,
        .service_not_found = discovery_service_not_found_cb,
        .error_found = discovery_error_found_cb,
    };
    
    int err = bt_gatt_dm_start(conn, BT_UUID_HIDS, &discovery_cb, NULL);
    if (err) {
        LOG_ERR("Could not start the discovery procedure, error: %d", err);
    }
}

void KeyboardInput_BLE::hogp_ready_cb(struct bt_hogp *hogp)
{
    LOG_INF("HOGP client ready");
    
    if (instance) {
        instance->ready = true;
        
        // Subscribe to all input reports (like Nordic sample does)
        int err;
        struct bt_hogp_rep_info *rep = NULL;
        
        while (NULL != (rep = bt_hogp_rep_next(hogp, rep))) {
            if (bt_hogp_rep_type(rep) == BT_HIDS_REPORT_TYPE_INPUT) {
                LOG_INF("Subscribe to report id: %u", bt_hogp_rep_id(rep));
                err = bt_hogp_rep_subscribe(hogp, rep, hogp_rep_handler);
                if (err) {
                    LOG_ERR("Subscribe error (%d)", err);
                }
            }
        }
        
        // Also subscribe to boot keyboard report if available
        if (hogp->rep_boot.kbd_inp) {
            LOG_INF("Subscribe to boot keyboard report");
            err = bt_hogp_rep_subscribe(hogp, hogp->rep_boot.kbd_inp, hogp_rep_handler);
            if (err) {
                LOG_ERR("Subscribe error (%d)", err);
            }
        }
    }
}

void KeyboardInput_BLE::hogp_pm_update_cb(struct bt_hogp *hogp)
{
    LOG_DBG("HOGP protocol mode updated");
}

uint8_t KeyboardInput_BLE::hogp_rep_handler(struct bt_hogp *hogp,
                                           struct bt_hogp_rep_info *rep,
                                           uint8_t err,
                                           const uint8_t *data)
{
    if (err) {
        LOG_ERR("HOGP report error: %d", err);
        return BT_GATT_ITER_STOP;
    }
    
    if (!data) {
        return BT_GATT_ITER_STOP;
    }
    
    uint8_t size = bt_hogp_rep_size(rep);
    
    if (instance && size >= 8) {
        LOG_DBG("Received HID report (id: %u, size: %u): %02x %02x %02x %02x %02x %02x %02x %02x",
                bt_hogp_rep_id(rep), size,
                data[0], data[1], data[2], data[3], data[4], data[5], data[6], data[7]);
        
        instance->processKeyboardReport(data, size);
    }
    
    return BT_GATT_ITER_CONTINUE;
}

void KeyboardInput_BLE::processKeyboardReport(const uint8_t* report, uint16_t length)
{
    if (!keyboardController || length < 8) {
        return;
    }
    
    // Standard USB HID keyboard report format:
    // Byte 0: Modifier keys
    // Byte 1: Reserved
    // Bytes 2-7: Key codes (up to 6 simultaneous keys)
    
    current_report.modifiers = report[0];
    current_report.key_count = 0;
    
    // Extract pressed keys
    for (int i = 2; i < 8 && i < length; i++) {
        if (report[i] != 0 && current_report.key_count < 6) {
            current_report.keys[current_report.key_count++] = report[i];
        }
    }
    
    // Forward the complete report to the PCD68 keyboard controller
    keyboardController->updateMultiKey(&report[2], 6, report[0]);
    
    LOG_DBG("Processed keyboard report: mod=0x%02x, keys=%d", 
            current_report.modifiers, current_report.key_count);
}
```

## src/KeyboardInput_BLE.h
```c
#pragma once

#include "../src/KeyboardInput.h"
#include <zephyr/kernel.h>
#include <zephyr/bluetooth/bluetooth.h>
#include <zephyr/bluetooth/gatt.h>
#include <zephyr/bluetooth/uuid.h>
#include <bluetooth/gatt_dm.h>
#include <bluetooth/services/hogp.h>
#include <bluetooth/scan.h>

class KeyboardInput_BLE : public KeyboardInput {
public:
    KeyboardInput_BLE();
    ~KeyboardInput_BLE();
    
    int init() override;
    bool poll() override;
    
    void setKeyboardController(class KCTL* controller) {
        keyboardController = controller;
    }
    
    uint8_t asciiToHID(char ascii);
    char hidToAscii(uint8_t hid);
    
public:
    // Bluetooth callbacks (must be public for C callback registration)
    static void scan_start();
    static void scan_filter_match(struct bt_scan_device_info *device_info,
                                 struct bt_scan_filter_match *filter_match,
                                 bool connectable);
    static void scan_connecting_error(struct bt_scan_device_info *device_info);
    static void scan_connecting(struct bt_scan_device_info *device_info,
                               struct bt_conn *conn);
    static void scan_filter_no_match(struct bt_scan_device_info *device_info,
                                    bool connectable);
    
    // Connection callbacks
    static void connected_cb(struct bt_conn *conn, uint8_t err);
    static void disconnected_cb(struct bt_conn *conn, uint8_t reason);
    static void security_changed_cb(struct bt_conn *conn, bt_security_t level,
                                   enum bt_security_err err);
                                   
private:
    
    // GATT Discovery callbacks
    static void discovery_completed_cb(struct bt_gatt_dm *dm, void *context);
    static void discovery_service_not_found_cb(struct bt_conn *conn, void *context);
    static void discovery_error_found_cb(struct bt_conn *conn, int err, void *context);
    static void gatt_discover(struct bt_conn *conn);
    
    // HOGP callbacks
    static void hogp_ready_cb(struct bt_hogp *hogp);
    static void hogp_pm_update_cb(struct bt_hogp *hogp);
    static uint8_t hogp_rep_handler(struct bt_hogp *hogp,
                                   struct bt_hogp_rep_info *rep,
                                   uint8_t err,
                                   const uint8_t *data);
    
    // HID report processing
    void processKeyboardReport(const uint8_t* report, uint16_t length);
    
    class KCTL* keyboardController;
    struct bt_conn* current_conn;
    struct bt_hogp hogp_client;
    
    // HID keycode to ASCII mapping
    static const uint8_t hid_to_ascii[256];
    
    // Current keyboard state
    struct {
        uint8_t modifiers;
        uint8_t keys[6];
        uint8_t key_count;
    } current_report;
    
    // BLE scanning and connection state
    bool scanning;
    bool connected;
    bool ready;
    
    // Static instance for callbacks
    static KeyboardInput_BLE* instance;
};
```

## src/KeyboardInput_Zephyr.h
```c
#ifndef KEYBOARDINPUT_ZEPHYR_H
#define KEYBOARDINPUT_ZEPHYR_H

#include <zephyr/kernel.h>
#include <zephyr/device.h>
#include <zephyr/input/input.h>

class KCTL;  // Forward declaration

class KeyboardInput_Zephyr {
public:
    KeyboardInput_Zephyr();
    virtual ~KeyboardInput_Zephyr();
    
    bool init();
    void poll();
    void setKeyboardController(KCTL* kctl) { keyboardController = kctl; }
    
private:
    KCTL* keyboardController;
    const struct device* input_dev;
    const struct device* uart_dev;
    
    // USB HID key mapping
    static const uint8_t hid_to_ascii[256];
    
    // Input event callback
    static void input_event_handler(struct input_event *evt, void *user_data);
    
    // UART keyboard helper methods
    void handleKeyPress(uint8_t keycode);
    void handleKeyRelease(uint8_t keycode);
    void sendCurrentReport();
    
    // Current key state
    struct {
        uint8_t modifiers;
        uint8_t keys[6];  // Standard USB HID allows up to 6 simultaneous keys
        uint8_t key_count;
    } current_report;
};

#endif // KEYBOARDINPUT_ZEPHYR_H
```

## src/Storage_Zephyr.h
```c
#ifndef STORAGE_ZEPHYR_H
#define STORAGE_ZEPHYR_H

#include <zephyr/kernel.h>
#include <zephyr/storage/flash_map.h>
#include <zephyr/fs/fs.h>

class Storage_Zephyr {
public:
    Storage_Zephyr();
    virtual ~Storage_Zephyr();
    
    bool init();
    bool loadRom(const char* filename, uint8_t* buffer, size_t max_size);
    bool saveFile(const char* filename, const uint8_t* data, size_t size);
    bool loadFile(const char* filename, uint8_t* buffer, size_t max_size, size_t* actual_size = nullptr);
    bool fileExists(const char* filename);
    bool deleteFile(const char* filename);
    
    // List files in storage
    bool listFiles(void (*callback)(const char* filename, size_t size, void* user_data), void* user_data);

private:
    static struct fs_mount_t fs_mnt;
    bool initialized;
    
    const char* getFullPath(const char* filename);
    static char full_path_buffer[256];
};

#endif // STORAGE_ZEPHYR_H
```
