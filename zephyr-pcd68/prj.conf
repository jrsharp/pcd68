## CMakeLists.txt
```
# SPDX-License-Identifier: Apache-2.0

cmake_minimum_required(VERSION 3.20.0)

find_package(Zephyr REQUIRED HINTS $ENV{ZEPHYR_BASE})
project(pcd68_zephyr)

# Get the parent directory path for PCD68 sources
get_filename_component(PCD68_ROOT "${CMAKE_CURRENT_SOURCE_DIR}/.." ABSOLUTE)

# Add include directories
target_include_directories(app PRIVATE 
    ${PCD68_ROOT}/src
    ${PCD68_ROOT}/src/Moira
    ${CMAKE_CURRENT_SOURCE_DIR}/src
)

# Core PCD68 sources (relative to parent directory)
target_sources(app PRIVATE
    ${PCD68_ROOT}/src/PCD68_CPU.cpp
    ${PCD68_ROOT}/src/TDA.cpp
    ${PCD68_ROOT}/src/KCTL.cpp
    ${PCD68_ROOT}/src/UART.cpp
    ${PCD68_ROOT}/src/Screen.cpp
    ${PCD68_ROOT}/src/Moira/Moira.cpp
    ${PCD68_ROOT}/src/Moira/MoiraDebugger.cpp
)

# Zephyr-specific implementations
target_sources(app PRIVATE
    src/main.cpp
    src/Screen_Zephyr.cpp
    src/KeyboardInput_Zephyr.cpp
    src/Storage_Zephyr.cpp
)

# Set C++ standard
set_property(TARGET app PROPERTY CXX_STANDARD 17)

# Compiler flags for the 68000 emulation
target_compile_options(app PRIVATE
    -Wno-narrowing
    -DUSE_ZEPHYR=1
    -DESP32S3_TARGET=1
)

# For ESP32-S3 specific optimizations
if(CONFIG_SOC_SERIES_ESP32S3)
    target_compile_options(app PRIVATE
        -mlongcalls
        -mtext-section-literals
    )
endif()
```

## Kconfig
```
# PCD68 Zephyr Configuration

mainmenu "PCD68 Emulator Configuration"

config PCD68_RAM_SIZE_MB
    int "RAM size in megabytes"
    default 4
    range 1 8
    help
      Amount of RAM to allocate for the emulated system in megabytes.
      Default is 4MB which matches the original PCD68 specification.

config PCD68_ROM_SIZE_KB
    int "ROM size in kilobytes"
    default 64
    range 32 256
    help
      Size of ROM space in kilobytes. Default is 64KB.

config PCD68_ENABLE_EINK_EMULATION
    bool "Enable E-Ink display emulation"
    default y
    help
      Enable E-Ink display characteristics emulation (ghosting, refresh delays).
      Disable for faster display updates.

config PCD68_EINK_PARTIAL_REFRESH
    bool "Enable E-Ink partial refresh"
    default y
    depends on PCD68_ENABLE_EINK_EMULATION
    help
      Enable partial refresh for E-paper displays to reduce ghosting
      and improve battery life. Only refreshes changed regions.

config PCD68_EINK_REFRESH_RATE_MS
    int "E-Ink refresh rate in milliseconds"
    default 2000
    range 100 10000
    depends on PCD68_ENABLE_EINK_EMULATION
    help
      Minimum time between full E-paper refreshes in milliseconds.
      Typical values: 1000-5000ms for E-paper, 33ms for LCD.

config PCD68_EINK_PARTIAL_THRESHOLD
    int "Partial refresh threshold percentage"
    default 25
    range 1 100
    depends on PCD68_EINK_PARTIAL_REFRESH
    help
      Maximum percentage of screen that can change before forcing
      a full refresh instead of partial refresh. Lower values
      favor partial refreshes.

config PCD68_EINK_GHOSTING_EMULATION
    bool "Enable E-Ink ghosting emulation"
    default n
    depends on PCD68_ENABLE_EINK_EMULATION
    help
      Emulate E-paper ghosting effects for authentic retro feel.
      May impact performance.

config PCD68_DISPLAY_DRIVER
    string "Display driver selection"
    default "ILI9341" if BOARD_ESP32S3_DEVKITM
    help
      Select the display driver to use. Options include:
      - ILI9341 (320x240 SPI LCD)
      - EPD (E-paper display)
      - SSD1306 (OLED)

config PCD68_DISPLAY_SPI_FREQUENCY
    int "Display SPI frequency in Hz"
    default 40000000
    range 1000000 80000000
    help
      SPI frequency for display communication in Hz.

config PCD68_KEYBOARD_TYPE
    string "Keyboard input type"
    default "USB_HID"
    help
      Select keyboard input method:
      - USB_HID (USB keyboard via ESP32-S3 USB host)
      - I2C_KEYBOARD (I2C-based keyboard controller)
      - UART_TERMINAL (Serial terminal input)
      - MATRIX (GPIO matrix keyboard)

config PCD68_ENABLE_UART1
    bool "Enable UART1"
    default y
    help
      Enable the first UART peripheral.

config PCD68_ENABLE_UART2
    bool "Enable UART2"
    default n
    help
      Enable the second UART peripheral.

config PCD68_UART1_DEVICE
    string "UART1 device"
    default "UART_2"
    depends on PCD68_ENABLE_UART1
    help
      Device name for UART1 (e.g., UART_2 for ESP32-S3).

config PCD68_UART2_DEVICE
    string "UART2 device"
    default "UART_1"
    depends on PCD68_ENABLE_UART2
    help
      Device name for UART2.

config PCD68_STORAGE_TYPE
    string "Storage type for ROMs"
    default "FLASH"
    help
      Storage location for ROM files:
      - FLASH (Internal flash partition)
      - SDCARD (SD card via SPI)
      - LITTLEFS (LittleFS filesystem)

config PCD68_DEFAULT_ROM
    string "Default ROM to load"
    default "jonsharp.bin"
    help
      Name of the default ROM file to load at startup.

config PCD68_ENABLE_WIFI
    bool "Enable WiFi support"
    default n
    select WIFI
    select WIFI_ESP32
    help
      Enable WiFi for network features (future: telnet, file transfer).

config PCD68_ENABLE_BLUETOOTH
    bool "Enable Bluetooth support"
    default n
    select BT
    select BT_PERIPHERAL
    help
      Enable Bluetooth for wireless keyboard/serial support.

config PCD68_CPU_THROTTLE
    bool "Enable CPU throttling"
    default y
    help
      Throttle the 68000 CPU to approximate original speed.
      Disable for maximum emulation speed.

config PCD68_TARGET_CPU_MHZ
    int "Target CPU speed in MHz"
    default 8
    range 1 16
    depends on PCD68_CPU_THROTTLE
    help
      Target 68000 CPU speed in MHz for throttling.

config PCD68_DEBUG_LEVEL
    int "Debug output level"
    default 1
    range 0 3
    help
      Debug output verbosity:
      0 - No debug output
      1 - Basic status messages
      2 - Detailed peripheral access
      3 - Full CPU trace

source "Kconfig.zephyr"
```

## west.yml
```
manifest:
  self:
    path: zephyr-pcd68

  remotes:
    - name: zephyrproject-rtos
      url-base: https://github.com/zephyrproject-rtos

  projects:
    # Reference external Zephyr installation
    - name: zephyr
      path: zephyr
      url: file:///mnt2/src/zephyr
      revision: HEAD
      import:
        # Import essential modules only
        name-allowlist:
          - hal_espressif

    # Directly include hal_espressif since it's required for ESP32
    - name: hal_espressif
      remote: zephyrproject-rtos
      revision: aa5443a4eea6a49d58f808f41bceb5de19678fa6
      path: modules/hal/espressif
      west-commands: west/west-commands.yml
```

## prj.conf
```kconfig
# ESP32-S3 Configuration for PCD68 Emulator

# Board configuration
CONFIG_SOC_SERIES_ESP32S3=y

# System
CONFIG_MAIN_STACK_SIZE=8192
CONFIG_SYSTEM_WORKQUEUE_STACK_SIZE=4096
CONFIG_HEAP_MEM_POOL_SIZE=32768

# C++ Support
CONFIG_CPP=y
CONFIG_STD_CPP17=y
CONFIG_CPP_EXCEPTIONS=n
CONFIG_CPP_RTTI=n

# Logging
CONFIG_LOG=y
CONFIG_LOG_DEFAULT_LEVEL=2
CONFIG_LOG_BUFFER_SIZE=2048

# Console
CONFIG_CONSOLE=y
CONFIG_UART_CONSOLE=y
CONFIG_SERIAL=y

# SPI for Display
CONFIG_SPI=y
CONFIG_SPI_ESP32_SPIM=y
CONFIG_GPIO=y

# Display Subsystem
CONFIG_DISPLAY=y
CONFIG_FRAMEBUFFER=y

# LCD Display Drivers (choose one)
CONFIG_ILI9341=y
CONFIG_ILI9341_RGB565=n  # We'll use monochrome
# CONFIG_ST7735R=y
# CONFIG_SSD1306=y

# E-paper Display Drivers (choose one for E-paper)
# CONFIG_SSD16XX=y               # Generic SSD16xx E-paper controller
# CONFIG_GOOD_DISPLAY_GDEY042T81=y  # Waveshare 4.2" E-paper (400x300)
# CONFIG_GOOD_DISPLAY_GDEY029T94=y  # Waveshare 2.9" E-paper
# CONFIG_SSD1680=y               # SSD1680 E-paper controller
# CONFIG_SSD1681=y               # SSD1681 E-paper controller

# Display Buffer Configuration
CONFIG_DISPLAY_BUFFER_SIZE=32768   # Adjust based on display size

# USB Support for keyboard
CONFIG_USB_DEVICE_STACK=y
CONFIG_USB_DEVICE_HID=y

# Flash & Storage
CONFIG_FLASH=y
CONFIG_FLASH_MAP=y
CONFIG_FLASH_PAGE_LAYOUT=y
CONFIG_MPU_ALLOW_FLASH_WRITE=y

# File Systems
CONFIG_FILE_SYSTEM=y
CONFIG_FILE_SYSTEM_LITTLEFS=y

# Timing
CONFIG_COUNTER=y
CONFIG_TIMER=y

# Memory
CONFIG_MINIMAL_LIBC_MALLOC_ARENA_SIZE=16384

# PCD68 Specific Configuration
CONFIG_PCD68_RAM_SIZE_MB=4
CONFIG_PCD68_ROM_SIZE_KB=64

# Display Configuration (LCD vs E-paper)
CONFIG_PCD68_ENABLE_EINK_EMULATION=n        # Set to 'y' for E-paper displays
CONFIG_PCD68_EINK_PARTIAL_REFRESH=y         # Enable partial refresh for E-paper
CONFIG_PCD68_EINK_REFRESH_RATE_MS=2000      # 2 second refresh rate for E-paper
CONFIG_PCD68_EINK_PARTIAL_THRESHOLD=25      # 25% change threshold for partial refresh
CONFIG_PCD68_EINK_GHOSTING_EMULATION=n      # Disable ghosting emulation for performance

CONFIG_PCD68_DISPLAY_DRIVER="ILI9341"       # Change to "SSD16XX" for E-paper
CONFIG_PCD68_DISPLAY_SPI_FREQUENCY=40000000

# Input Configuration
CONFIG_PCD68_KEYBOARD_TYPE="USB_HID"

# Peripheral Configuration
CONFIG_PCD68_ENABLE_UART1=y
CONFIG_PCD68_ENABLE_UART2=n

# Storage Configuration
CONFIG_PCD68_STORAGE_TYPE="LITTLEFS"
CONFIG_PCD68_DEFAULT_ROM="jonsharp.bin"

# CPU Emulation Configuration
CONFIG_PCD68_CPU_THROTTLE=y
CONFIG_PCD68_TARGET_CPU_MHZ=8
CONFIG_PCD68_DEBUG_LEVEL=1

# Optional: WiFi support
# CONFIG_WIFI=y
# CONFIG_WIFI_ESP32=y
# CONFIG_NET_L2_ETHERNET=y
# CONFIG_NET_DHCPV4=y

# Optional: Bluetooth support for wireless keyboard
# CONFIG_BT=y
# CONFIG_BT_PERIPHERAL=y
# CONFIG_BT_DEVICE_NAME="PCD68-Keyboard"

# Power Management
CONFIG_PM=n  # Disable for consistent emulation performance

# Watchdog
CONFIG_WATCHDOG=y
CONFIG_WDT_DISABLE_AT_BOOT=y
```

## prj_epaper.conf
```kconfig
# ESP32-S3 Configuration for PCD68 Emulator - E-paper Display Version

# Board configuration
CONFIG_SOC_SERIES_ESP32S3=y

# System
CONFIG_MAIN_STACK_SIZE=8192
CONFIG_SYSTEM_WORKQUEUE_STACK_SIZE=4096
CONFIG_HEAP_MEM_POOL_SIZE=32768

# C++ Support
CONFIG_CPP=y
CONFIG_STD_CPP17=y
CONFIG_CPP_EXCEPTIONS=n
CONFIG_CPP_RTTI=n

# Logging
CONFIG_LOG=y
CONFIG_LOG_DEFAULT_LEVEL=2
CONFIG_LOG_BUFFER_SIZE=2048

# Console
CONFIG_CONSOLE=y
CONFIG_UART_CONSOLE=y
CONFIG_SERIAL=y

# SPI for Display
CONFIG_SPI=y
CONFIG_SPI_ESP32_SPIM=y
CONFIG_GPIO=y

# Display Subsystem
CONFIG_DISPLAY=y
CONFIG_FRAMEBUFFER=y

# E-paper Display Drivers (enable appropriate one)
CONFIG_SSD16XX=y                     # Generic SSD16xx E-paper controller
# CONFIG_GOOD_DISPLAY_GDEY042T81=y  # Waveshare 4.2" E-paper (400x300)
# CONFIG_SSD1680=y                  # SSD1680 E-paper controller
# CONFIG_SSD1681=y                  # SSD1681 E-paper controller

# Display Buffer Configuration
CONFIG_DISPLAY_BUFFER_SIZE=15000     # 400x300/8 = ~15KB for monochrome

# USB Support for keyboard
CONFIG_USB_DEVICE_STACK=y
CONFIG_USB_DEVICE_HID=y

# Flash & Storage
CONFIG_FLASH=y
CONFIG_FLASH_MAP=y
CONFIG_FLASH_PAGE_LAYOUT=y
CONFIG_MPU_ALLOW_FLASH_WRITE=y

# File Systems
CONFIG_FILE_SYSTEM=y
CONFIG_FILE_SYSTEM_LITTLEFS=y

# Timing
CONFIG_COUNTER=y
CONFIG_TIMER=y

# Memory
CONFIG_MINIMAL_LIBC_MALLOC_ARENA_SIZE=16384

# PCD68 Specific Configuration for E-paper
CONFIG_PCD68_RAM_SIZE_MB=4
CONFIG_PCD68_ROM_SIZE_KB=64

# E-paper Display Configuration
CONFIG_PCD68_ENABLE_EINK_EMULATION=y        # Enable E-paper characteristics
CONFIG_PCD68_EINK_PARTIAL_REFRESH=y         # Enable partial refresh
CONFIG_PCD68_EINK_REFRESH_RATE_MS=2000      # 2 second refresh rate
CONFIG_PCD68_EINK_PARTIAL_THRESHOLD=25      # 25% change threshold
CONFIG_PCD68_EINK_GHOSTING_EMULATION=n      # Disable for performance

CONFIG_PCD68_DISPLAY_DRIVER="SSD16XX"       # E-paper driver
CONFIG_PCD68_DISPLAY_SPI_FREQUENCY=4000000  # Lower frequency for E-paper (4MHz)

# Input Configuration
CONFIG_PCD68_KEYBOARD_TYPE="USB_HID"

# Peripheral Configuration
CONFIG_PCD68_ENABLE_UART1=y
CONFIG_PCD68_ENABLE_UART2=n

# Storage Configuration
CONFIG_PCD68_STORAGE_TYPE="LITTLEFS"
CONFIG_PCD68_DEFAULT_ROM="jonsharp.bin"

# CPU Emulation Configuration (slower for E-paper)
CONFIG_PCD68_CPU_THROTTLE=y
CONFIG_PCD68_TARGET_CPU_MHZ=4               # Slower CPU for E-paper power efficiency
CONFIG_PCD68_DEBUG_LEVEL=2                  # Higher debug level for development

# Power Management (important for E-paper displays)
CONFIG_PM=y
CONFIG_PM_DEVICE=y

# Watchdog (gentler settings for E-paper)
CONFIG_WATCHDOG=y
CONFIG_WDT_DISABLE_AT_BOOT=y

# Optional: Enable deep sleep between E-paper refreshes
# CONFIG_PM_DEEP_SLEEP_STATES=y
```

## src/main.cpp
```c
#include <zephyr/kernel.h>
#include <zephyr/device.h>
#include <zephyr/drivers/display.h>
#include <zephyr/drivers/gpio.h>
#include <zephyr/drivers/spi.h>
#include <zephyr/logging/log.h>
#include <zephyr/sys/printk.h>
#include <zephyr/storage/flash_map.h>
#include <zephyr/fs/fs.h>
#include <zephyr/fs/littlefs.h>

#include "PCD68_CPU.h"
#include "TDA.h"
#include "KCTL.h"
#include "UART.h"
#include "Screen_Zephyr.h"
#include "KeyboardInput_Zephyr.h"
#include "Storage_Zephyr.h"

LOG_MODULE_REGISTER(pcd68_main, CONFIG_PCD68_DEBUG_LEVEL);

// Global emulator components
static u8* systemRom = nullptr;
static u8* systemRam = nullptr;
static CPU* pcdCpu = nullptr;
static TDA* textDisplayAdapter = nullptr;
static KCTL* keyboardController = nullptr;
static UART* uartController = nullptr;
static Screen_Zephyr* pcdScreen = nullptr;
static KeyboardInput_Zephyr* keyboardInput = nullptr;
static Storage_Zephyr* storage = nullptr;

// Emulation timing
static uint32_t cycles_per_iteration = 1000;
static uint32_t target_cpu_hz = CONFIG_PCD68_TARGET_CPU_MHZ * 1000000;
static uint32_t iteration_delay_us = (cycles_per_iteration * 1000000) / target_cpu_hz;

// Thread stacks
K_THREAD_STACK_DEFINE(emulation_stack, 8192);
K_THREAD_STACK_DEFINE(display_stack, 4096);
K_THREAD_STACK_DEFINE(input_stack, 2048);

struct k_thread emulation_thread;
struct k_thread display_thread;
struct k_thread input_thread;

// Synchronization
K_SEM_DEFINE(display_sem, 0, 1);
K_MUTEX_DEFINE(cpu_mutex);

// Display refresh rate (Hz)
#define DISPLAY_REFRESH_RATE 30
#define DISPLAY_REFRESH_MS (1000 / DISPLAY_REFRESH_RATE)

// Forward declarations
void emulation_thread_entry(void *p1, void *p2, void *p3);
void display_thread_entry(void *p1, void *p2, void *p3);
void input_thread_entry(void *p1, void *p2, void *p3);

static int init_hardware(void)
{
    LOG_INF("Initializing hardware for PCD68 on ESP32-S3");
    
    // Initialize display
    const struct device *display_dev = DEVICE_DT_GET(DT_CHOSEN(zephyr_display));
    if (!device_is_ready(display_dev)) {
        LOG_ERR("Display device not ready");
        return -ENODEV;
    }
    
    // Get display capabilities
    struct display_capabilities caps;
    display_get_capabilities(display_dev, &caps);
    LOG_INF("Display: %dx%d, pixel format: %d", 
            caps.x_resolution, caps.y_resolution, caps.current_pixel_format);
    
    return 0;
}

static int init_storage(void)
{
    LOG_INF("Initializing storage");
    
    storage = new Storage_Zephyr();
    if (!storage->init()) {
        LOG_ERR("Failed to initialize storage");
        return -EIO;
    }
    
    return 0;
}

static int load_rom(const char *rom_filename)
{
    LOG_INF("Loading ROM: %s", rom_filename);
    
    size_t rom_size = CONFIG_PCD68_ROM_SIZE_KB * 1024;
    systemRom = new u8[rom_size];
    memset(systemRom, 0xFF, rom_size);
    
    // Try to load ROM from storage
    if (!storage->loadRom(rom_filename, systemRom, rom_size)) {
        LOG_WRN("Failed to load ROM from storage, using default pattern");
        // Initialize with a basic pattern or embedded ROM
        // For now, just a simple infinite loop at reset vector
        systemRom[0] = 0x00;  // Initial SP high
        systemRom[1] = 0x00;
        systemRom[2] = 0x10;
        systemRom[3] = 0x00;  // Initial SP low (0x001000)
        systemRom[4] = 0x00;  // Initial PC high
        systemRom[5] = 0x00;
        systemRom[6] = 0x00;
        systemRom[7] = 0x08;  // Initial PC low (0x000008)
        // Simple infinite loop: BRA.S *
        systemRom[8] = 0x60;
        systemRom[9] = 0xFE;
    }
    
    return 0;
}

static int init_emulator(void)
{
    LOG_INF("Initializing PCD68 emulator components");
    
    // Allocate RAM
    size_t ram_size = CONFIG_PCD68_RAM_SIZE_MB * 1024 * 1024;
    systemRam = new u8[ram_size];
    if (!systemRam) {
        LOG_ERR("Failed to allocate %d MB RAM", CONFIG_PCD68_RAM_SIZE_MB);
        return -ENOMEM;
    }
    memset(systemRam, 0, ram_size);
    
    // Load ROM
    int ret = load_rom(CONFIG_PCD68_DEFAULT_ROM);
    if (ret < 0) {
        return ret;
    }
    
    // Create CPU
    pcdCpu = new CPU();
    pcdCpu->setSystemRom(systemRom, CONFIG_PCD68_ROM_SIZE_KB * 1024);
    pcdCpu->setSystemRam(systemRam, ram_size);
    
    // Create peripherals
    textDisplayAdapter = new TDA(0x410000);
    keyboardController = new KCTL(0x420000);
    uartController = new UART(0x450000);
    
    // Create Zephyr-specific screen implementation
    pcdScreen = new Screen_Zephyr(0x810000);
    pcdScreen->init();
    
    // Create Zephyr-specific keyboard input
    keyboardInput = new KeyboardInput_Zephyr();
    keyboardInput->init();
    keyboardInput->setKeyboardController(keyboardController);
    
    // Connect peripherals to CPU
    pcdCpu->addPeripheral(textDisplayAdapter);
    pcdCpu->addPeripheral(keyboardController);
    pcdCpu->addPeripheral(uartController);
    pcdCpu->addPeripheral(pcdScreen);
    
    // Connect TDA to screen
    textDisplayAdapter->setScreen(pcdScreen);
    
    // Reset CPU
    pcdCpu->reset();
    pcdCpu->setIPL(0x00);
    
    LOG_INF("Emulator initialized successfully");
    return 0;
}

void emulation_thread_entry(void *p1, void *p2, void *p3)
{
    ARG_UNUSED(p1);
    ARG_UNUSED(p2);
    ARG_UNUSED(p3);
    
    LOG_INF("Emulation thread started");
    
    uint32_t last_time = k_uptime_get_32();
    uint32_t cycles_executed = 0;
    
    while (1) {
        k_mutex_lock(&cpu_mutex, K_FOREVER);
        
        // Execute CPU cycles
        cycles_executed += pcdCpu->execute(cycles_per_iteration);
        
        // Check for interrupts
        if (keyboardController->hasInterrupt()) {
            pcdCpu->setIPL(0x03);  // Keyboard at level 3
        }
        
        k_mutex_unlock(&cpu_mutex);
        
        // Throttle CPU if enabled
        if (CONFIG_PCD68_CPU_THROTTLE) {
            k_usleep(iteration_delay_us);
        } else {
            k_yield();  // Just yield to other threads
        }
        
        // Periodic status
        uint32_t now = k_uptime_get_32();
        if (now - last_time >= 1000) {
            LOG_DBG("CPU: %u cycles/sec", cycles_executed);
            cycles_executed = 0;
            last_time = now;
        }
    }
}

void display_thread_entry(void *p1, void *p2, void *p3)
{
    ARG_UNUSED(p1);
    ARG_UNUSED(p2);
    ARG_UNUSED(p3);
    
    LOG_INF("Display thread started");
    
    while (1) {
        // Update display if needed
        if (pcdScreen->needsRefresh()) {
            k_mutex_lock(&cpu_mutex, K_FOREVER);
            pcdScreen->refresh();
            k_mutex_unlock(&cpu_mutex);
        }
        
        k_msleep(DISPLAY_REFRESH_MS);
    }
}

void input_thread_entry(void *p1, void *p2, void *p3)
{
    ARG_UNUSED(p1);
    ARG_UNUSED(p2);
    ARG_UNUSED(p3);
    
    LOG_INF("Input thread started");
    
    while (1) {
        // Poll for keyboard input
        keyboardInput->poll();
        
        // Small delay to avoid excessive polling
        k_msleep(10);
    }
}

int main(void)
{
    printk("PCD68 Emulator for Zephyr/ESP32-S3\n");
    printk("ROM: %dKB, RAM: %dMB\n", 
           CONFIG_PCD68_ROM_SIZE_KB, CONFIG_PCD68_RAM_SIZE_MB);
    
    // Initialize hardware
    int ret = init_hardware();
    if (ret < 0) {
        LOG_ERR("Hardware initialization failed: %d", ret);
        return ret;
    }
    
    // Initialize storage
    ret = init_storage();
    if (ret < 0) {
        LOG_ERR("Storage initialization failed: %d", ret);
        return ret;
    }
    
    // Initialize emulator
    ret = init_emulator();
    if (ret < 0) {
        LOG_ERR("Emulator initialization failed: %d", ret);
        return ret;
    }
    
    // Create threads
    k_thread_create(&emulation_thread, emulation_stack,
                    K_THREAD_STACK_SIZEOF(emulation_stack),
                    emulation_thread_entry,
                    NULL, NULL, NULL,
                    5, 0, K_NO_WAIT);
    k_thread_name_set(&emulation_thread, "pcd68_emu");
    
    k_thread_create(&display_thread, display_stack,
                    K_THREAD_STACK_SIZEOF(display_stack),
                    display_thread_entry,
                    NULL, NULL, NULL,
                    7, 0, K_NO_WAIT);
    k_thread_name_set(&display_thread, "pcd68_display");
    
    k_thread_create(&input_thread, input_stack,
                    K_THREAD_STACK_SIZEOF(input_stack),
                    input_thread_entry,
                    NULL, NULL, NULL,
                    6, 0, K_NO_WAIT);
    k_thread_name_set(&input_thread, "pcd68_input");
    
    LOG_INF("PCD68 emulator started");
    
    // Main thread can do other tasks or sleep
    while (1) {
        k_sleep(K_SECONDS(60));
        
        // Periodic health check
        LOG_INF("System healthy - uptime: %u seconds", k_uptime_get_32() / 1000);
    }
    
    return 0;
}
```

## src/KeyboardInput_Zephyr.cpp
```c
#include "KeyboardInput_Zephyr.h"
#include "KCTL.h"
#include <zephyr/logging/log.h>
#include <zephyr/input/input.h>

LOG_MODULE_DECLARE(pcd68_main);

// Basic HID keycode to ASCII mapping
const uint8_t KeyboardInput_Zephyr::hid_to_ascii[256] = {
    0, 0, 0, 0,           // 0x00-0x03: Reserved
    'a', 'b', 'c', 'd',   // 0x04-0x07: A-D
    'e', 'f', 'g', 'h',   // 0x08-0x0B: E-H
    'i', 'j', 'k', 'l',   // 0x0C-0x0F: I-L
    'm', 'n', 'o', 'p',   // 0x10-0x13: M-P
    'q', 'r', 's', 't',   // 0x14-0x17: Q-T
    'u', 'v', 'w', 'x',   // 0x18-0x1B: U-X
    'y', 'z',             // 0x1C-0x1D: Y-Z
    '1', '2', '3', '4',   // 0x1E-0x21: 1-4
    '5', '6', '7', '8',   // 0x22-0x25: 5-8
    '9', '0',             // 0x26-0x27: 9-0
    '\r', '\x1B', '\b',   // 0x28-0x2A: Enter, Escape, Backspace
    '\t', ' ',            // 0x2B-0x2C: Tab, Space
    '-', '=',             // 0x2D-0x2E: - =
    '[', ']',             // 0x2F-0x30: [ ]
    '\\', 0,              // 0x31-0x32: \ (non-US)
    ';', '\'',            // 0x33-0x34: ; '
    '`',                  // 0x35: `
    ',', '.', '/',        // 0x36-0x38: , . /
    0,                    // 0x39: Caps Lock
    0, 0, 0, 0, 0, 0, 0, 0, 0, 0, 0, 0,  // 0x3A-0x45: F1-F12
    0, 0, 0,              // 0x46-0x48: Print Screen, Scroll Lock, Pause
    0, 0, 0,              // 0x49-0x4B: Insert, Home, Page Up
    0, 0, 0,              // 0x4C-0x4E: Delete, End, Page Down
    0, 0, 0, 0,           // 0x4F-0x52: Arrow keys
    0,                    // 0x53: Num Lock
    '/', '*', '-', '+',   // 0x54-0x57: Keypad operators
    '\r',                 // 0x58: Keypad Enter
    '1', '2', '3', '4',   // 0x59-0x5C: Keypad 1-4
    '5', '6', '7', '8',   // 0x5D-0x60: Keypad 5-8
    '9', '0', '.',        // 0x61-0x63: Keypad 9, 0, .
    // Rest initialized to 0
};

KeyboardInput_Zephyr::KeyboardInput_Zephyr()
    : keyboardController(nullptr), input_dev(nullptr)
{
    memset(&current_report, 0, sizeof(current_report));
}

KeyboardInput_Zephyr::~KeyboardInput_Zephyr()
{
}

bool KeyboardInput_Zephyr::init()
{
    LOG_INF("Initializing keyboard input");
    
    // For now, we'll handle input through console or other means
    // In a full implementation, you'd initialize USB HID host or other input device
    
#ifdef CONFIG_INPUT
    // Try to find an input device
    input_dev = DEVICE_DT_GET_ANY(input_gpio_keys);
    if (input_dev && device_is_ready(input_dev)) {
        LOG_INF("Found input device: %s", input_dev->name);
        
        // Register input callback
        input_callback_set(input_dev, input_event_handler, this);
        return true;
    }
#endif
    
    LOG_WRN("No input device found, using console input simulation");
    return true;
}

void KeyboardInput_Zephyr::poll()
{
    // For console-based input simulation, we could read from console here
    // In a real implementation, this would be handled by input callbacks
    
    static uint32_t last_key_time = 0;
    static uint8_t test_key = 0x04;  // 'A' key for testing
    
    // Simple test: inject a key press every 5 seconds for testing
    uint32_t now = k_uptime_get_32();
    if (now - last_key_time > 5000) {
        if (keyboardController) {
            // Simulate key press
            current_report.key_count = 1;
            current_report.keys[0] = test_key++;
            if (test_key > 0x1D) test_key = 0x04;  // A-Z range
            
            // Send report to keyboard controller
            uint8_t report[8] = {0};
            report[0] = current_report.modifiers;
            report[1] = 0;  // Reserved
            memcpy(&report[2], current_report.keys, 6);
            
            keyboardController->receiveReport(report, 8);
            
            LOG_DBG("Sent test key report: 0x%02x", current_report.keys[0]);
        }
        last_key_time = now;
    }
}

void KeyboardInput_Zephyr::input_event_handler(struct input_event *evt, void *user_data)
{
    KeyboardInput_Zephyr *kbd = static_cast<KeyboardInput_Zephyr*>(user_data);
    
    if (!kbd || !kbd->keyboardController) {
        return;
    }
    
    LOG_DBG("Input event: type=%d, code=%d, value=%d", evt->type, evt->code, evt->value);
    
    // Handle different input event types
    switch (evt->type) {
        case INPUT_EV_KEY: {
            uint8_t hid_code = evt->code;  // Assuming direct HID mapping
            
            if (evt->value) {
                // Key press - add to report if not already present
                bool found = false;
                for (int i = 0; i < kbd->current_report.key_count; i++) {
                    if (kbd->current_report.keys[i] == hid_code) {
                        found = true;
                        break;
                    }
                }
                
                if (!found && kbd->current_report.key_count < 6) {
                    kbd->current_report.keys[kbd->current_report.key_count++] = hid_code;
                }
            } else {
                // Key release - remove from report
                for (int i = 0; i < kbd->current_report.key_count; i++) {
                    if (kbd->current_report.keys[i] == hid_code) {
                        // Shift remaining keys down
                        memmove(&kbd->current_report.keys[i], 
                               &kbd->current_report.keys[i + 1],
                               kbd->current_report.key_count - i - 1);
                        kbd->current_report.key_count--;
                        break;
                    }
                }
            }
            
            // Send updated report
            uint8_t report[8] = {0};
            report[0] = kbd->current_report.modifiers;
            report[1] = 0;  // Reserved
            memcpy(&report[2], kbd->current_report.keys, 6);
            
            kbd->keyboardController->receiveReport(report, 8);
            break;
        }
        
        default:
            // Ignore other event types for now
            break;
    }
}
```

## src/KeyboardInput_Zephyr.h
```c
#ifndef KEYBOARDINPUT_ZEPHYR_H
#define KEYBOARDINPUT_ZEPHYR_H

#include <zephyr/kernel.h>
#include <zephyr/device.h>
#include <zephyr/input/input.h>

class KCTL;  // Forward declaration

class KeyboardInput_Zephyr {
public:
    KeyboardInput_Zephyr();
    virtual ~KeyboardInput_Zephyr();
    
    bool init();
    void poll();
    void setKeyboardController(KCTL* kctl) { keyboardController = kctl; }
    
private:
    KCTL* keyboardController;
    const struct device* input_dev;
    
    // USB HID key mapping
    static const uint8_t hid_to_ascii[256];
    
    // Input event callback
    static void input_event_handler(struct input_event *evt, void *user_data);
    
    // Current key state
    struct {
        uint8_t modifiers;
        uint8_t keys[6];  // Standard USB HID allows up to 6 simultaneous keys
        uint8_t key_count;
    } current_report;
};

#endif // KEYBOARDINPUT_ZEPHYR_H
```

## src/Screen_Zephyr.cpp
```c
#include "Screen_Zephyr.h"
#include <zephyr/logging/log.h>
#include <zephyr/kernel.h>
#include <string.h>

LOG_MODULE_DECLARE(pcd68_main);

Screen_Zephyr::Screen_Zephyr(u32 baseAddress) 
    : Screen(baseAddress), display_dev(nullptr), framebuffer(nullptr), previous_frame(nullptr),
      dirty(false), framebuffer_supported(false), is_epaper(false), 
      partial_refresh_enabled(true), refresh_rate_ms(CONFIG_PCD68_ENABLE_EINK_EMULATION ? 2000 : 33),
      last_refresh_time(0), display_width(0), display_height(0), 
      pixel_format(PIXEL_FORMAT_MONO10), dirty_region_count(0)
{
    memset(dirty_regions, 0, sizeof(dirty_regions));
}

Screen_Zephyr::~Screen_Zephyr()
{
    if (framebuffer && framebuffer != previous_frame) {
        delete[] framebuffer;
    }
    if (previous_frame) {
        delete[] previous_frame;
    }
}

bool Screen_Zephyr::init()
{
    LOG_INF("Initializing PCD68 display");
    
    // Get display device from chosen node in device tree
    display_dev = DEVICE_DT_GET(DT_CHOSEN(zephyr_display));
    if (!device_is_ready(display_dev)) {
        LOG_ERR("Display device not ready");
        return false;
    }
    
    // Get display capabilities
    struct display_capabilities caps;
    display_get_capabilities(display_dev, &caps);
    display_width = caps.x_resolution;
    display_height = caps.y_resolution;
    pixel_format = caps.current_pixel_format;
    
    LOG_INF("Display: %dx%d, pixel format: %d", display_width, display_height, pixel_format);
    
    // Detect E-paper displays by driver name or capabilities
    const char* driver_name = display_dev->name;
    is_epaper = (strstr(driver_name, "ssd16") != nullptr) || 
                (strstr(driver_name, "epd") != nullptr) ||
                (strstr(driver_name, "waveshare") != nullptr);
    
    if (is_epaper) {
        LOG_INF("E-paper display detected: %s", driver_name);
        // E-paper displays typically need longer refresh intervals
        if (refresh_rate_ms < 1000) {
            refresh_rate_ms = 2000;  // 2 second minimum for E-paper
        }
    }
    
    // Try to use framebuffer if supported
    if (initFramebuffer()) {
        LOG_INF("Using framebuffer mode");
        framebuffer_supported = true;
    } else {
        LOG_INF("Using direct display mode");
        framebuffer_supported = false;
        if (!initDirectDisplay()) {
            return false;
        }
    }
    
    // Set display blanking off
    display_blanking_off(display_dev);
    
    // Initialize with a clear screen
    forceFullRefresh();
    
    return true;
}

bool Screen_Zephyr::initFramebuffer()
{
#ifdef CONFIG_FRAMEBUFFER
    // Try to get framebuffer
    uint8_t *fb_ptr;
    size_t fb_size;
    
    if (display_get_framebuffer(display_dev, &fb_ptr) == 0) {
        // Use driver's framebuffer directly
        framebuffer = fb_ptr;
        LOG_INF("Using driver framebuffer directly");
    } else {
        // Allocate our own framebuffer
        int bytes_per_pixel = 1;  // Default to monochrome
        
        switch (pixel_format) {
            case PIXEL_FORMAT_RGB_565:
            case PIXEL_FORMAT_BGR_565:
                bytes_per_pixel = 2;
                break;
            case PIXEL_FORMAT_RGB_888:
            case PIXEL_FORMAT_BGR_888:
                bytes_per_pixel = 3;
                break;
            case PIXEL_FORMAT_ARGB_8888:
                bytes_per_pixel = 4;
                break;
            case PIXEL_FORMAT_MONO01:
            case PIXEL_FORMAT_MONO10:
            default:
                bytes_per_pixel = 1;
                break;
        }
        
        size_t fb_size = display_width * display_height * bytes_per_pixel;
        framebuffer = new u8[fb_size];
        if (!framebuffer) {
            LOG_ERR("Failed to allocate framebuffer (%zu bytes)", fb_size);
            return false;
        }
        memset(framebuffer, 0, fb_size);
        LOG_INF("Allocated framebuffer: %zu bytes", fb_size);
    }
    
    // Allocate previous frame for dirty detection (E-paper optimization)
    if (is_epaper) {
        size_t frame_size = SCREEN_WIDTH * SCREEN_HEIGHT / 8;  // PCD68 mono framebuffer size
        previous_frame = new u8[frame_size];
        if (previous_frame) {
            memset(previous_frame, 0, frame_size);
        }
    }
    
    return true;
#else
    return false;
#endif
}

bool Screen_Zephyr::initDirectDisplay()
{
    // For direct display mode, we'll write directly to the display
    // Allocate a buffer for format conversion
    int bytes_per_pixel = (pixel_format == PIXEL_FORMAT_RGB_565 || pixel_format == PIXEL_FORMAT_BGR_565) ? 2 : 1;
    size_t buffer_size = display_width * display_height * bytes_per_pixel;
    
    framebuffer = new u8[buffer_size];
    if (!framebuffer) {
        LOG_ERR("Failed to allocate display buffer");
        return false;
    }
    memset(framebuffer, 0, buffer_size);
    
    return true;
}

void Screen_Zephyr::refresh()
{
    if (!dirty) {
        return;
    }
    
    // Rate limiting for E-paper displays
    uint32_t now = k_uptime_get_32();
    if (is_epaper && (now - last_refresh_time) < refresh_rate_ms) {
        return;  // Too soon for E-paper refresh
    }
    
    if (framebuffer_supported) {
        updateFramebuffer();
    } else {
        updateDirectDisplay();
    }
    
    last_refresh_time = now;
    dirty = false;
}

void Screen_Zephyr::updateFramebuffer()
{
#ifdef CONFIG_FRAMEBUFFER
    // Convert PCD68 400x300 monochrome to display format and resolution
    convertMonoToDisplay(framebuffer, screenBuffer, display_width, display_height);
    
    if (is_epaper && partial_refresh_enabled && previous_frame) {
        // For E-paper, try partial refresh if supported
        calculateDirtyRegions();
        
        if (shouldDoPartialRefresh() && dirty_region_count > 0) {
            // Perform partial refresh on dirty regions
            for (int i = 0; i < dirty_region_count; i++) {
                if (dirty_regions[i].active) {
                    performPartialRefresh(dirty_regions[i].x, dirty_regions[i].y,
                                        dirty_regions[i].width, dirty_regions[i].height);
                }
            }
        } else {
            performFullRefresh();
        }
        
        // Update previous frame
        memcpy(previous_frame, screenBuffer, SCREEN_BUFFER_SIZE);
    } else {
        // Direct framebuffer update for LCD or full E-paper refresh
        performFullRefresh();
    }
#endif
}

void Screen_Zephyr::updateDirectDisplay()
{
    // Convert and write directly to display
    convertMonoToDisplay(framebuffer, screenBuffer, display_width, display_height);
    
    struct display_buffer_descriptor desc = {
        .buf_size = display_width * display_height * 
                   ((pixel_format == PIXEL_FORMAT_RGB_565) ? 2 : 1),
        .pitch = display_width,
        .width = display_width,
        .height = display_height,
    };
    
    int ret = display_write(display_dev, 0, 0, &desc, framebuffer);
    if (ret < 0) {
        LOG_ERR("Display write failed: %d", ret);
    }
}

u8 Screen_Zephyr::read8(u32 address)
{
    u32 offset = address - baseAddress;
    if (offset < SCREEN_BUFFER_SIZE) {
        return screenBuffer[offset];
    }
    return 0;
}

void Screen_Zephyr::write8(u32 address, u8 value)
{
    u32 offset = address - baseAddress;
    if (offset < SCREEN_BUFFER_SIZE) {
        if (screenBuffer[offset] != value) {
            screenBuffer[offset] = value;
            dirty = true;
        }
    }
}

void Screen_Zephyr::convertMonoToDisplay(u8 *dest, const u8 *src, int dest_w, int dest_h)
{
    // If display resolution matches PCD68 exactly (like Waveshare 4.2")
    if (dest_w == SCREEN_WIDTH && dest_h == SCREEN_HEIGHT) {
        // Direct conversion without scaling
        for (int y = 0; y < dest_h; y++) {
            for (int x = 0; x < dest_w; x++) {
                // Get pixel from PCD68 monochrome buffer (1 bit per pixel)
                int bit_offset = y * SCREEN_WIDTH + x;
                int byte_offset = bit_offset / 8;
                int bit_pos = 7 - (bit_offset % 8);
                bool pixel = (src[byte_offset] >> bit_pos) & 1;
                
                // Convert to display format
                switch (pixel_format) {
                    case PIXEL_FORMAT_MONO01:
                        // Direct monochrome (0=black, 1=white)
                        if ((x % 8) == 0) dest[y * (dest_w/8) + x/8] = 0;
                        if (pixel) dest[y * (dest_w/8) + x/8] |= (0x80 >> (x % 8));
                        break;
                        
                    case PIXEL_FORMAT_MONO10:
                        // Inverse monochrome (1=black, 0=white) - common for E-paper
                        if ((x % 8) == 0) dest[y * (dest_w/8) + x/8] = 0xFF;
                        if (pixel) dest[y * (dest_w/8) + x/8] &= ~(0x80 >> (x % 8));
                        break;
                        
                    case PIXEL_FORMAT_RGB_565: {
                        uint16_t color = pixel ? 0xFFFF : 0x0000;
                        uint16_t *dest16 = (uint16_t*)dest;
                        dest16[y * dest_w + x] = color;
                        break;
                    }
                    
                    default:
                        // Grayscale fallback
                        dest[y * dest_w + x] = pixel ? 0xFF : 0x00;
                        break;
                }
            }
        }
    } else {
        // Scale from 400x300 to display resolution
        scaleFrame(dest, src, dest_w, dest_h, SCREEN_WIDTH, SCREEN_HEIGHT);
    }
}

void Screen_Zephyr::scaleFrame(u8 *dest, const u8 *src, int dest_w, int dest_h, int src_w, int src_h)
{
    float x_scale = (float)src_w / dest_w;
    float y_scale = (float)src_h / dest_h;
    
    for (int y = 0; y < dest_h; y++) {
        for (int x = 0; x < dest_w; x++) {
            // Find source pixel using nearest neighbor
            int src_x = (int)(x * x_scale);
            int src_y = (int)(y * y_scale);
            
            if (src_x >= src_w) src_x = src_w - 1;
            if (src_y >= src_h) src_y = src_h - 1;
            
            // Get pixel from monochrome source
            int bit_offset = src_y * src_w + src_x;
            int byte_offset = bit_offset / 8;
            int bit_pos = 7 - (bit_offset % 8);
            bool pixel = (src[byte_offset] >> bit_pos) & 1;
            
            // Convert to destination format (simplified)
            switch (pixel_format) {
                case PIXEL_FORMAT_RGB_565: {
                    uint16_t color = pixel ? 0xFFFF : 0x0000;
                    uint16_t *dest16 = (uint16_t*)dest;
                    dest16[y * dest_w + x] = color;
                    break;
                }
                default:
                    dest[y * dest_w + x] = pixel ? 0xFF : 0x00;
                    break;
            }
        }
    }
}

void Screen_Zephyr::calculateDirtyRegions()
{
    if (!previous_frame) return;
    
    dirty_region_count = 0;
    // Simple implementation: find changed areas
    // This could be optimized for better E-paper partial refresh
    
    bool found_changes = false;
    int min_x = SCREEN_WIDTH, min_y = SCREEN_HEIGHT;
    int max_x = 0, max_y = 0;
    
    for (int i = 0; i < SCREEN_BUFFER_SIZE; i++) {
        if (screenBuffer[i] != previous_frame[i]) {
            found_changes = true;
            // Convert byte offset to x,y coordinates
            int bit_offset = i * 8;
            int y = bit_offset / SCREEN_WIDTH;
            int x = bit_offset % SCREEN_WIDTH;
            
            if (x < min_x) min_x = x;
            if (x > max_x) max_x = x;
            if (y < min_y) min_y = y;
            if (y > max_y) max_y = y;
        }
    }
    
    if (found_changes) {
        // Create a single dirty region encompassing all changes
        dirty_regions[0].x = min_x;
        dirty_regions[0].y = min_y;
        dirty_regions[0].width = max_x - min_x + 8;  // +8 for byte boundary
        dirty_regions[0].height = max_y - min_y + 1;
        dirty_regions[0].active = true;
        dirty_region_count = 1;
    }
}

bool Screen_Zephyr::shouldDoPartialRefresh()
{
    // Use partial refresh for small changes on E-paper
    if (!is_epaper || dirty_region_count == 0) return false;
    
    int total_changed_area = 0;
    for (int i = 0; i < dirty_region_count; i++) {
        if (dirty_regions[i].active) {
            total_changed_area += dirty_regions[i].width * dirty_regions[i].height;
        }
    }
    
    int total_area = display_width * display_height;
    return (total_changed_area < total_area / 4);  // Less than 25% changed
}

void Screen_Zephyr::performPartialRefresh(int x, int y, int width, int height)
{
    // Try partial refresh if display supports it
    struct display_buffer_descriptor desc = {
        .buf_size = width * height * ((pixel_format == PIXEL_FORMAT_RGB_565) ? 2 : 1),
        .pitch = width,
        .width = width,
        .height = height,
    };
    
    // Create partial buffer
    size_t partial_size = width * height;
    u8 *partial_buffer = new u8[partial_size];
    if (!partial_buffer) {
        LOG_WRN("Failed to allocate partial refresh buffer, doing full refresh");
        performFullRefresh();
        return;
    }
    
    // Extract the region from framebuffer
    for (int py = 0; py < height; py++) {
        memcpy(&partial_buffer[py * width], 
               &framebuffer[(y + py) * display_width + x], 
               width);
    }
    
    int ret = display_write(display_dev, x, y, &desc, partial_buffer);
    delete[] partial_buffer;
    
    if (ret < 0) {
        LOG_WRN("Partial refresh failed: %d, doing full refresh", ret);
        performFullRefresh();
    } else {
        LOG_DBG("Partial refresh: %dx%d at (%d,%d)", width, height, x, y);
    }
}

void Screen_Zephyr::performFullRefresh()
{
    struct display_buffer_descriptor desc = {
        .buf_size = display_width * display_height * 
                   ((pixel_format == PIXEL_FORMAT_RGB_565) ? 2 : 1),
        .pitch = display_width,
        .width = display_width,
        .height = display_height,
    };
    
    int ret = display_write(display_dev, 0, 0, &desc, framebuffer);
    if (ret < 0) {
        LOG_ERR("Full refresh failed: %d", ret);
    } else {
        LOG_DBG("Full display refresh completed");
    }
}

void Screen_Zephyr::forceFullRefresh()
{
    dirty = true;
    if (framebuffer_supported) {
        updateFramebuffer();
    } else {
        updateDirectDisplay();
    }
    dirty = false;
}
```

## src/Screen_Zephyr.h
```c
#ifndef SCREEN_ZEPHYR_H
#define SCREEN_ZEPHYR_H

#include "Screen.h"
#include <zephyr/device.h>
#include <zephyr/drivers/display.h>

class Screen_Zephyr : public Screen {
public:
    Screen_Zephyr(u32 baseAddress);
    virtual ~Screen_Zephyr();
    
    bool init();
    void refresh();
    bool needsRefresh() const { return dirty; }
    
    // Override Screen virtual methods
    virtual u8 read8(u32 address) override;
    virtual void write8(u32 address, u8 value) override;
    
    // E-paper specific methods
    void setPartialRefresh(bool enabled) { partial_refresh_enabled = enabled; }
    void setRefreshRate(uint32_t rate_ms) { refresh_rate_ms = rate_ms; }
    void forceFullRefresh();
    
private:
    const struct device *display_dev;
    u8 *framebuffer;         // Framebuffer for display output
    u8 *previous_frame;      // Previous frame for dirty detection
    bool dirty;
    bool framebuffer_supported;
    bool is_epaper;
    bool partial_refresh_enabled;
    uint32_t refresh_rate_ms;
    uint32_t last_refresh_time;
    
    int display_width;
    int display_height;
    enum display_pixel_format pixel_format;
    
    // Display management
    bool initFramebuffer();
    bool initDirectDisplay();
    void updateFramebuffer();
    void updateDirectDisplay();
    
    // Format conversion
    void convertMonoToDisplay(u8 *dest, const u8 *src, int width, int height);
    void scaleFrame(u8 *dest, const u8 *src, int dest_w, int dest_h, int src_w, int src_h);
    
    // E-paper optimizations
    void calculateDirtyRegions();
    bool shouldDoPartialRefresh();
    void performPartialRefresh(int x, int y, int width, int height);
    void performFullRefresh();
    
    // Dirty region tracking for E-paper
    struct dirty_region {
        int x, y, width, height;
        bool active;
    } dirty_regions[4];  // Support up to 4 dirty regions
    int dirty_region_count;
};

#endif // SCREEN_ZEPHYR_H
```
